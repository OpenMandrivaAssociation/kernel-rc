## loongarch-omv-defconfig
```kconfig
CONFIG_16KB_3LEVEL=y
CONFIG_64BIT=y
CONFIG_842_COMPRESS=m
CONFIG_842_DECOMPRESS=m
CONFIG_ACPI=y
CONFIG_ACPI_AC=y
CONFIG_ACPI_BATTERY=y
CONFIG_ACPI_BGRT=y
CONFIG_ACPI_BUTTON=y
CONFIG_ACPI_CONTAINER=y
CONFIG_ACPI_CPU_FREQ_PSS=y
CONFIG_ACPI_DOCK=y
CONFIG_ACPI_FAN=y
CONFIG_ACPI_GENERIC_GSI=y
CONFIG_ACPI_HOTPLUG_CPU=y
CONFIG_ACPI_HOTPLUG_MEMORY=y
CONFIG_ACPI_I2C_OPREGION=y
CONFIG_ACPI_IPMI=m
CONFIG_ACPI_MCFG=y
CONFIG_ACPI_MDIO=y
CONFIG_ACPI_NUMA=y
CONFIG_ACPI_PCI_SLOT=y
CONFIG_ACPI_PPTT=y
CONFIG_ACPI_PROCESSOR=y
CONFIG_ACPI_PROCESSOR_IDLE=y
CONFIG_ACPI_SLEEP=y
CONFIG_ACPI_SPCR_TABLE=y
CONFIG_ACPI_SYSTEM_POWER_STATES_SUPPORT=y
CONFIG_ACPI_TABLE_UPGRADE=y
CONFIG_ACPI_TAD=y
CONFIG_ACPI_THERMAL=y
CONFIG_ACPI_THERMAL_LIB=y
CONFIG_ACPI_VIDEO=y
CONFIG_AHCI_DWC=y
CONFIG_ALLOW_DEV_COREDUMP=y
CONFIG_APERTURE_HELPERS=y
CONFIG_ARCH_BINFMT_ELF_STATE=y
CONFIG_ARCH_DISABLE_KASAN_INLINE=y
CONFIG_ARCH_ENABLE_MEMORY_HOTPLUG=y
CONFIG_ARCH_ENABLE_MEMORY_HOTREMOVE=y
CONFIG_ARCH_ENABLE_THP_MIGRATION=y
CONFIG_ARCH_FORCE_MAX_ORDER=11
CONFIG_ARCH_HAS_ACPI_TABLE_UPGRADE=y
CONFIG_ARCH_HAS_CPU_FINALIZE_INIT=y
CONFIG_ARCH_HAS_GENERIC_CRASHKERNEL_RESERVATION=y
CONFIG_ARCH_HAS_KCOV=y
CONFIG_ARCH_HAS_NMI_SAFE_THIS_CPU_OPS=y
CONFIG_ARCH_KEEP_MEMBLOCK=y
CONFIG_ARCH_MEMORY_PROBE=y
CONFIG_ARCH_MIGHT_HAVE_PC_PARPORT=y
CONFIG_ARCH_MIGHT_HAVE_PC_SERIO=y
CONFIG_ARCH_MMAP_RND_BITS=12
CONFIG_ARCH_MMAP_RND_BITS_MAX=18
CONFIG_ARCH_MMAP_RND_BITS_MIN=12
CONFIG_ARCH_SELECTS_CRASH_DUMP=y
CONFIG_ARCH_SELECT_MEMORY_MODEL=y
CONFIG_ARCH_STACKWALK=y
CONFIG_ARCH_STRICT_ALIGN=y
CONFIG_ARCH_SUPPORTS_ACPI=y
CONFIG_ARCH_SUPPORTS_CRASH_DUMP=y
CONFIG_ARCH_SUPPORTS_HUGETLBFS=y
CONFIG_ARCH_SUPPORTS_KEXEC=y
CONFIG_ARCH_SUPPORTS_LTO_CLANG=y
CONFIG_ARCH_SUPPORTS_LTO_CLANG_THIN=y
CONFIG_ARCH_SUPPORTS_NUMA_BALANCING=y
CONFIG_ARCH_USE_BUILTIN_BSWAP=y
CONFIG_ARCH_USE_CMPXCHG_LOCKREF=y
CONFIG_ARCH_USE_MEMREMAP_PROT=y
CONFIG_ARCH_USE_QUEUED_RWLOCKS=y
CONFIG_ARCH_USE_QUEUED_SPINLOCKS=y
CONFIG_ARCH_WANTS_NO_INSTR=y
CONFIG_ARCH_WANT_DEFAULT_TOPDOWN_MMAP_LAYOUT=y
CONFIG_ARCH_WANT_LD_ORPHAN_WARN=y
CONFIG_ARCH_WANT_OPTIMIZE_HUGETLB_VMEMMAP=y
CONFIG_ARCH_WANT_PMD_MKWRITE=y
CONFIG_ATA_ACPI=y
CONFIG_ATA_FORCE=y
CONFIG_ATA_VERBOSE_ERROR=y
CONFIG_AUDIT=y
CONFIG_AUDITSYSCALL=y
CONFIG_AUDIT_GENERIC=y
CONFIG_BLK_CGROUP_FC_APPID=y
CONFIG_BLK_CGROUP_IOCOST=y
CONFIG_BLK_CGROUP_IOLATENCY=y
CONFIG_BLK_CGROUP_IOPRIO=y
CONFIG_BLK_CGROUP_PUNT_BIO=y
CONFIG_BLK_DEBUG_FS=y
CONFIG_BLK_DEBUG_FS_ZONED=y
CONFIG_BLK_DEV_BSG_COMMON=y
CONFIG_BLK_DEV_INTEGRITY_T10=y
CONFIG_BLK_DEV_RAM=y
CONFIG_BLK_DEV_RAM_SIZE=8192
CONFIG_BLK_DEV_RBD=m
CONFIG_BLK_DEV_SD=y
CONFIG_BLK_DEV_SR=y
CONFIG_BLK_DEV_THROTTLING_LOW=y
CONFIG_BLK_DEV_ZONED=y
CONFIG_BLK_ICQ=y
CONFIG_BLK_MQ_STACKING=y
CONFIG_BLK_RQ_ALLOC_TIME=y
CONFIG_BLK_WBT=y
CONFIG_BLK_WBT_MQ=y
CONFIG_BLOCK_HOLDER_DEPRECATED=y
CONFIG_BLOCK_LEGACY_AUTOLOAD=y
CONFIG_BPF_UNPRIV_DEFAULT_OFF=y
CONFIG_BSD_DISKLABEL=y
CONFIG_BSD_PROCESS_ACCT_V3=y
CONFIG_BUG=y
CONFIG_CARDBUS=y
CONFIG_CC_IMPLICIT_FALLTHROUGH="-Wimplicit-fallthrough=5"
CONFIG_CC_NO_ARRAY_BOUNDS=y
CONFIG_CC_NO_STRINGOP_OVERFLOW=y
CONFIG_CC_OPTIMIZE_FOR_PERFORMANCE=y
CONFIG_CDROM=y
CONFIG_CFG80211_WEXT=y
CONFIG_CHARGER_BQ24190=m
CONFIG_CLOSURES=y
CONFIG_CMA_AREAS=19
CONFIG_CMA_SIZE_MBYTES=0
CONFIG_CMDLINE=""
CONFIG_CMDLINE_BOOTLOADER=y
CONFIG_CMDLINE_PARTITION=y
CONFIG_COMEDI=m
CONFIG_COMEDI_8254=m
CONFIG_COMEDI_8255=m
CONFIG_COMEDI_8255_PCI=m
CONFIG_COMEDI_ADL_PCI6208=m
CONFIG_COMEDI_ADL_PCI7250=m
CONFIG_COMEDI_ADL_PCI7X3X=m
CONFIG_COMEDI_ADL_PCI8164=m
CONFIG_COMEDI_ADL_PCI9111=m
CONFIG_COMEDI_ADL_PCI9118=m
CONFIG_COMEDI_ADV_PCI1710=m
CONFIG_COMEDI_ADV_PCI1720=m
CONFIG_COMEDI_ADV_PCI1723=m
CONFIG_COMEDI_ADV_PCI1724=m
CONFIG_COMEDI_ADV_PCI1760=m
CONFIG_COMEDI_ADV_PCI_DIO=m
CONFIG_COMEDI_DEFAULT_BUF_MAXSIZE_KB=20480
CONFIG_COMEDI_DEFAULT_BUF_SIZE_KB=2048
CONFIG_COMEDI_MITE=m
CONFIG_COMEDI_NI_LABPC=m
CONFIG_COMEDI_NI_LABPC_PCI=m
CONFIG_COMEDI_NI_PCIDIO=m
CONFIG_COMEDI_NI_PCIMIO=m
CONFIG_COMEDI_NI_ROUTING=m
CONFIG_COMEDI_NI_TIO=m
CONFIG_COMEDI_NI_TIOCMD=m
CONFIG_COMEDI_PCI_DRIVERS=m
CONFIG_COMMON_CLK_LOONGSON2=y
CONFIG_COMPACT_UNEVICTABLE_DEFAULT=1
CONFIG_CONTEXT_TRACKING=y
CONFIG_CONTEXT_TRACKING_IDLE=y
CONFIG_CORE_DUMP_DEFAULT_ELF_HEADERS=y
CONFIG_CPU_FREQ_DEFAULT_GOV_ONDEMAND=y
CONFIG_CPU_FREQ_GOV_CONSERVATIVE=m
CONFIG_CPU_FREQ_GOV_PERFORMANCE=m
CONFIG_CPU_FREQ_GOV_POWERSAVE=m
CONFIG_CPU_FREQ_GOV_USERSPACE=m
CONFIG_CPU_HAS_FPU=y
CONFIG_CPU_HAS_LASX=y
CONFIG_CPU_HAS_LBT=y
CONFIG_CPU_HAS_LSX=y
CONFIG_CPU_HAS_PREFETCH=y
CONFIG_CPU_MITIGATIONS=y
CONFIG_CPU_PM=y
CONFIG_CRAMFS_BLOCKDEV=y
CONFIG_CRASH_CORE=y
CONFIG_CRASH_DM_CRYPT=y
CONFIG_CRASH_DUMP=y
CONFIG_CRC16=y
CONFIG_CRC64=y
CONFIG_CRC64_ROCKSOFT=y
CONFIG_CRC_ITU_T=y
CONFIG_CRYPTO_AEAD=y
CONFIG_CRYPTO_CRC32=m
CONFIG_CRYPTO_CRC32C=y
CONFIG_CRYPTO_CRC32_LOONGARCH=m
CONFIG_CRYPTO_CRC64_ROCKSOFT=y
CONFIG_CRYPTO_CRYPTD=m
CONFIG_CRYPTO_CTR=m
CONFIG_CRYPTO_DEV_LOONGSON_RNG=m
CONFIG_CRYPTO_DH=y
CONFIG_CRYPTO_DRBG=m
CONFIG_CRYPTO_DRBG_MENU=m
CONFIG_CRYPTO_ECHAINIV=m
CONFIG_CRYPTO_ENGINE=m
CONFIG_CRYPTO_GENIV=m
CONFIG_CRYPTO_JITTERENTROPY=m
CONFIG_CRYPTO_JITTERENTROPY_MEMORY_BLOCKS=64
CONFIG_CRYPTO_JITTERENTROPY_MEMORY_BLOCKSIZE=32
CONFIG_CRYPTO_JITTERENTROPY_OSR=1
CONFIG_CRYPTO_KDF800108_CTR=y
CONFIG_CRYPTO_KPP=y
CONFIG_CRYPTO_LIB_CHACHA_GENERIC=m
CONFIG_CRYPTO_LIB_GF128MUL=m
CONFIG_CRYPTO_LIB_POLY1305_GENERIC=m
CONFIG_CRYPTO_LIB_POLY1305_RSIZE=1
CONFIG_CRYPTO_LIB_SHA1=y
CONFIG_CRYPTO_LIB_UTILS=y
CONFIG_CRYPTO_LZ4=m
CONFIG_CRYPTO_LZ4HC=m
CONFIG_CRYPTO_LZO=m
CONFIG_CRYPTO_NULL=m
CONFIG_CRYPTO_NULL2=m
CONFIG_CRYPTO_PCRYPT=m
CONFIG_CRYPTO_RNG=m
CONFIG_CRYPTO_RNG_DEFAULT=m
CONFIG_CRYPTO_SHA3=m
CONFIG_CRYPTO_SIG2=y
CONFIG_CRYPTO_USER_API=m
CONFIG_CRYPTO_USER_API_AEAD=m
CONFIG_CXD2880_SPI_DRV=m
CONFIG_DEBUG_BUGVERBOSE=y
CONFIG_DEBUG_FS=y
CONFIG_DEBUG_FS_ALLOW_ALL=y
CONFIG_DEBUG_KERNEL=y
CONFIG_DEBUG_MISC=y
CONFIG_DECOMPRESS_BZIP2=y
CONFIG_DECOMPRESS_LZ4=y
CONFIG_DECOMPRESS_LZMA=y
CONFIG_DECOMPRESS_LZO=y
CONFIG_DEFAULT_HOSTNAME="(none)"
CONFIG_DEFAULT_MMAP_MIN_ADDR=4096
CONFIG_DEVFREQ_GOV_POWERSAVE=y
CONFIG_DEVFREQ_GOV_USERSPACE=y
CONFIG_DEVICE_PRIVATE=y
CONFIG_DEV_COREDUMP=y
CONFIG_DEV_DAX=m
CONFIG_DEV_DAX_KMEM=m
CONFIG_DMABUF_HEAPS=y
CONFIG_DMABUF_HEAPS_CMA=y
CONFIG_DMABUF_HEAPS_CMA_LEGACY=y
CONFIG_DMABUF_HEAPS_SYSTEM=y
CONFIG_DMA_ACPI=y
CONFIG_DMA_DECLARE_COHERENT=y
CONFIG_DMA_OF=y
CONFIG_DMI_SCAN_MACHINE_NON_EFI_FALLBACK=y
CONFIG_DM_PCACHE=m
CONFIG_DRM_AMDGPU_USERPTR=y
CONFIG_DRM_AMD_DC=y
CONFIG_DRM_AMD_DC_FP=y
CONFIG_DRM_AST=y
CONFIG_DRM_BUDDY=m
CONFIG_DRM_CLIENT_DEFAULT_FBDEV=y
CONFIG_DRM_DISPLAY_DP_HELPER=y
CONFIG_DRM_DISPLAY_HDCP_HELPER=y
CONFIG_DRM_DISPLAY_HDMI_HELPER=y
CONFIG_DRM_DISPLAY_HELPER=m
CONFIG_DRM_EFIDRM=m
CONFIG_DRM_EXEC=m
CONFIG_DRM_GEM_SHMEM_HELPER=y
CONFIG_DRM_MICROCHIP_LVDS_SERIALIZER=m
CONFIG_DRM_PANEL_ORIENTATION_QUIRKS=y
CONFIG_DRM_QXL=m
CONFIG_DRM_RADEON_USERPTR=y
CONFIG_DRM_SCHED=m
CONFIG_DRM_SUBALLOC_HELPER=m
CONFIG_DTC=y
CONFIG_DUMMY=y
CONFIG_DUMMY_CONSOLE_ROWS=25
CONFIG_DVB_CXD2099=m
CONFIG_DVB_CXD2880=m
CONFIG_DVB_DIB9000=m
CONFIG_DVB_DYNAMIC_MINORS=y
CONFIG_DVB_LGS8GL5=m
CONFIG_DVB_LNBH29=m
CONFIG_DVB_MB86A16=m
CONFIG_DVB_MN88443X=m
CONFIG_DVB_MXL5XX=m
CONFIG_DVB_MXL692=m
CONFIG_DVB_NET=y
CONFIG_DVB_S5H1432=m
CONFIG_DVB_SP2=m
CONFIG_DVB_STV0910=m
CONFIG_DVB_STV6111=m
CONFIG_DVB_TDA665x=m
CONFIG_DVB_ZD1301_DEMOD=m
CONFIG_EDAC_LOONGSON=m
CONFIG_EEPROM_AT24=m
CONFIG_EFI_CAPSULE_LOADER=m
CONFIG_EFI_CUSTOM_SSDT_OVERLAYS=y
CONFIG_EFI_EARLYCON=y
CONFIG_EFI_ESRT=y
CONFIG_EFI_GENERIC_STUB=y
CONFIG_EFI_RUNTIME_WRAPPERS=y
CONFIG_EFI_SBAT_FILE=""
CONFIG_EFI_STUB=y
CONFIG_EFI_TEST=m
CONFIG_EFI_ZBOOT=y
CONFIG_EXT2_FS_POSIX_ACL=y
CONFIG_EXT2_FS_SECURITY=y
CONFIG_EXT2_FS_XATTR=y
CONFIG_EXT3_FS_POSIX_ACL=y
CONFIG_EXT3_FS_SECURITY=y
CONFIG_EXTCON_FSA9480=m
CONFIG_EXTCON_GPIO=m
CONFIG_EXTCON_MAX3355=m
CONFIG_EXTCON_PTN5150=m
CONFIG_EXTCON_RT8973A=m
CONFIG_EXTCON_SM5502=m
CONFIG_EXTCON_USB_GPIO=m
CONFIG_FAILOVER=m
CONFIG_FB_CORE=y
CONFIG_FB_DDC=y
CONFIG_FB_DEVICE=y
CONFIG_FB_EFI=y
CONFIG_FB_IOMEM_FOPS=y
CONFIG_FB_IOMEM_HELPERS=y
CONFIG_FB_RADEON=y
CONFIG_FB_RADEON_BACKLIGHT=y
CONFIG_FB_RADEON_I2C=y
CONFIG_FB_SYSMEM_FOPS=y
CONFIG_FB_SYSMEM_HELPERS=y
CONFIG_FB_SYSMEM_HELPERS_DEFERRED=y
CONFIG_FB_SYS_COPYAREA=y
CONFIG_FB_SYS_FILLRECT=y
CONFIG_FB_SYS_IMAGEBLIT=y
CONFIG_FCOE=m
CONFIG_FIRMWARE_TABLE=y
CONFIG_FS_STACK=y
CONFIG_FUNCTION_ALIGNMENT=0
CONFIG_FWNODE_MDIO=y
CONFIG_GCC10_NO_ARRAY_BOUNDS=y
CONFIG_GCC_ASM_GOTO_OUTPUT_WORKAROUND=y
CONFIG_GCC_NO_STRINGOP_OVERFLOW=y
CONFIG_GENERIC_BUG=y
CONFIG_GENERIC_BUG_RELATIVE_POINTERS=y
CONFIG_GENERIC_CMOS_UPDATE=y
CONFIG_GENERIC_CPU_DEVICES=y
CONFIG_GENERIC_CSUM=y
CONFIG_GENERIC_ENTRY=y
CONFIG_GENERIC_HWEIGHT=y
CONFIG_GENERIC_IOREMAP=y
CONFIG_GENERIC_IRQ_MULTI_HANDLER=y
CONFIG_GENERIC_LIB_ASHLDI3=y
CONFIG_GENERIC_LIB_ASHRDI3=y
CONFIG_GENERIC_LIB_CMPDI2=y
CONFIG_GENERIC_LIB_DEVMEM_IS_ALLOWED=y
CONFIG_GENERIC_LIB_LSHRDI3=y
CONFIG_GENERIC_LIB_UCMPDI2=y
CONFIG_GENERIC_SCHED_CLOCK=y
CONFIG_GENERIC_VDSO_TIME_NS=y
CONFIG_GFS2_FS_LOCKING_DLM=y
CONFIG_GPIO_ACPI=y
CONFIG_GPIO_CDEV_V1=y
CONFIG_GPIO_GENERIC=y
CONFIG_GPIO_LOONGSON_64BIT=y
CONFIG_HAS_IOPORT=y
CONFIG_HAS_IOPORT_MAP=y
CONFIG_HIBERNATION_COMP_LZ4=y
CONFIG_HSA_AMD=y
CONFIG_HSA_AMD_SVM=y
CONFIG_HWMON_VID=m
CONFIG_HW_RANDOM_VIRTIO=m
CONFIG_HZ=250
CONFIG_HZ_250=y
CONFIG_I2C=y
CONFIG_I2C_ALGOBIT=y
CONFIG_I2C_CHARDEV=y
CONFIG_I2C_DESIGNWARE_CORE=y
CONFIG_I2C_DESIGNWARE_PLATFORM=y
CONFIG_I2C_GPIO=y
CONFIG_I2C_LS2X=y
CONFIG_I2C_MUX_GPIO=m
CONFIG_I2C_MUX_LTC4306=m
CONFIG_I2C_MUX_MLXCPLD=m
CONFIG_I2C_MUX_PCA9541=m
CONFIG_I2C_MUX_PCA954x=m
CONFIG_I2C_PIIX4=y
CONFIG_I2C_SLAVE_EEPROM=m
CONFIG_I2C_SLAVE_TESTUNIT=m
CONFIG_I2C_USBIO=m
CONFIG_I2C_ZHAOXIN=m
CONFIG_INFINIBAND_BNXT_RE=m
CONFIG_INFINIBAND_IONIC=m
CONFIG_INFINIBAND_VIRT_DMA=y
CONFIG_INPUT_EVDEV=y
CONFIG_INPUT_MOUSE=y
CONFIG_INPUT_MOUSEDEV=y
CONFIG_INPUT_MOUSEDEV_PSAUX=y
CONFIG_INPUT_MOUSEDEV_SCREEN_X=1024
CONFIG_INPUT_MOUSEDEV_SCREEN_Y=768
CONFIG_INPUT_SPARSEKMAP=y
CONFIG_INPUT_VIVALDIFMAP=y
CONFIG_INTEGRITY=y
CONFIG_INTEGRITY_AUDIT=y
CONFIG_IOMMU_DEFAULT_DMA_STRICT=y
CONFIG_IPE_BOOT_POLICY=""
CONFIG_IPMI_DMI_DECODE=y
CONFIG_IPMI_LS2K=y
CONFIG_IRQCHIP=y
CONFIG_IRQ_BYPASS_MANAGER=m
CONFIG_IRQ_FASTEOI_HIERARCHY_HANDLERS=y
CONFIG_IRQ_LOONGARCH_CPU=y
CONFIG_ISCSI_TARGET=m
CONFIG_KALLSYMS_ALL=y
CONFIG_KCMP=y
CONFIG_KERNEL_GZIP=y
CONFIG_KEXEC=y
CONFIG_KEXEC_CORE=y
CONFIG_KEXEC_FILE=y
CONFIG_KEY_DH_OPERATIONS=y
CONFIG_KVM=m
CONFIG_L1_CACHE_SHIFT=6
CONFIG_LEGACY_PTYS=y
CONFIG_LEGACY_PTY_COUNT=16
CONFIG_LEGACY_TIOCSTI=y
CONFIG_LIBCRC32C=y
CONFIG_LIBFCOE=m
CONFIG_LIBFDT=y
CONFIG_LOCK_DEBUGGING_SUPPORT=y
CONFIG_LOCK_MM_AND_FIND_VMA=y
CONFIG_LOGO=y
CONFIG_LOGO_LINUX_CLUT224=y
CONFIG_LOGO_LINUX_MONO=y
CONFIG_LOGO_LINUX_VGA16=y
CONFIG_LOG_BUF_SHIFT=18
CONFIG_LOONGARCH=y
CONFIG_LOONGARCH_PLATFORM_DEVICES=y
CONFIG_LOONGSON2_APB_DMA=m
CONFIG_LOONGSON2_GUTS=y
CONFIG_LOONGSON2_PM=y
CONFIG_LOONGSON2_THERMAL=m
CONFIG_LOONGSON3_CPUFREQ=m
CONFIG_LOONGSON_EIOINTC=y
CONFIG_LOONGSON_HTVEC=y
CONFIG_LOONGSON_LAPTOP=y
CONFIG_LOONGSON_LIOINTC=y
CONFIG_LOONGSON_PCH_LPC=y
CONFIG_LOONGSON_PCH_MSI=y
CONFIG_LOONGSON_PCH_PIC=y
CONFIG_LOOPBACK_TARGET=m
CONFIG_LS2X_APB_DMA=y
CONFIG_LSM_MMAP_MIN_ADDR=65536
CONFIG_LTO_NONE=y
CONFIG_LZ4HC_COMPRESS=m
CONFIG_LZ4_COMPRESS=m
CONFIG_LZ4_DECOMPRESS=y
CONFIG_LZO_COMPRESS=y
CONFIG_LZO_DECOMPRESS=y
CONFIG_MACH_LOONGSON64=y
CONFIG_MAGIC_SYSRQ_DEFAULT_ENABLE=0x1
CONFIG_MANAGER_SBS=m
CONFIG_MDIO_BUS=y
CONFIG_MDIO_DEVICE=y
CONFIG_MDIO_DEVRES=y
CONFIG_MD_BITMAP_FILE=y
CONFIG_MEDIA_CEC_RC=y
CONFIG_MEDIA_TEST_SUPPORT=y
CONFIG_MEDIA_TUNER_MSI001=m
CONFIG_MEDIA_TUNER_MXL301RF=m
CONFIG_MEDIA_TUNER_QM1D1B0004=m
CONFIG_MEMFD_CREATE=y
CONFIG_MEMORY_HOTPLUG=y
CONFIG_MEMORY_HOTPLUG_DEFAULT_ONLINE=y
CONFIG_MEMORY_HOTREMOVE=y
CONFIG_MFD_88PM886_PMIC=y
CONFIG_MFD_LOONGSON_SE=m
CONFIG_MHP_DEFAULT_ONLINE_TYPE_ONLINE_AUTO=y
CONFIG_MII=y
CONFIG_MMU_GATHER_MERGE_VMAS=y
CONFIG_MMU_LAZY_TLB_REFCOUNT=y
CONFIG_MODULES_USE_ELF_RELA=y
CONFIG_MOUSE_PS2=y
CONFIG_MOUSE_PS2_ALPS=y
CONFIG_MOUSE_PS2_BYD=y
CONFIG_MOUSE_PS2_CYPRESS=y
CONFIG_MOUSE_PS2_ELANTECH=y
CONFIG_MOUSE_PS2_ELANTECH_SMBUS=y
CONFIG_MOUSE_PS2_FOCALTECH=y
CONFIG_MOUSE_PS2_LOGIPS2PP=y
CONFIG_MOUSE_PS2_PIXART=y
CONFIG_MOUSE_PS2_SENTELIC=y
CONFIG_MOUSE_PS2_SMBUS=y
CONFIG_MOUSE_PS2_SYNAPTICS=y
CONFIG_MOUSE_PS2_SYNAPTICS_SMBUS=y
CONFIG_MOUSE_PS2_TRACKPOINT=y
CONFIG_MOUSE_SERIAL=m
CONFIG_MPTCP_IPV6=y
CONFIG_MQ_IOSCHED_KYBER=y
CONFIG_MTD=m
CONFIG_MTD_BLKDEVS=m
CONFIG_MTD_BLOCK=m
CONFIG_MTD_CFI=m
CONFIG_MTD_CFI_AMDSTD=m
CONFIG_MTD_CFI_INTELEXT=m
CONFIG_MTD_CFI_UTIL=m
CONFIG_MTD_GEN_PROBE=m
CONFIG_MTD_JEDECPROBE=m
CONFIG_MTD_UBI=m
CONFIG_MTD_UBI_BLOCK=y
CONFIG_MUX_ADGS1408=m
CONFIG_NEED_PER_CPU_EMBED_FIRST_CHUNK=y
CONFIG_NEED_PER_CPU_PAGE_FIRST_CHUNK=y
CONFIG_NET_9P=y
CONFIG_NET_9P_FD=y
CONFIG_NET_9P_VIRTIO=y
CONFIG_NET_FAILOVER=m
CONFIG_NET_SELFTESTS=y
CONFIG_NET_XGRESS=y
CONFIG_NFS_V4_SECURITY_LABEL=y
CONFIG_NODES_SHIFT=6
CONFIG_NR_CPUS=256
CONFIG_NTB=m
CONFIG_NTB_EPF=m
CONFIG_NTB_IDT=m
CONFIG_NTB_MSI=y
CONFIG_NTB_PERF=m
CONFIG_NTB_SWITCHTEC=m
CONFIG_NTB_TRANSPORT=m
CONFIG_NUMA=y
CONFIG_NUMA_BALANCING=y
CONFIG_NUMA_BALANCING_DEFAULT_ENABLED=y
CONFIG_NUMA_KEEP_MEMINFO=y
CONFIG_NVMEM_LAYOUTS=y
CONFIG_OF=y
CONFIG_OF_ADDRESS=y
CONFIG_OF_EARLY_FLATTREE=y
CONFIG_OF_FLATTREE=y
CONFIG_OF_GPIO=y
CONFIG_OF_IOMMU=y
CONFIG_OF_IRQ=y
CONFIG_OF_KOBJ=y
CONFIG_OF_MDIO=y
CONFIG_OF_RESERVED_MEM=y
CONFIG_PADATA=y
CONFIG_PAGE_BLOCK_MAX_ORDER=11
CONFIG_PAGE_BLOCK_ORDER=11
CONFIG_PAGE_SIZE_16KB=y
CONFIG_PAGE_SIZE_LESS_THAN_256KB=y
CONFIG_PAGE_SIZE_LESS_THAN_64KB=y
CONFIG_PANIC_TIMEOUT=0
CONFIG_PARAVIRT=y
CONFIG_PARPORT=y
CONFIG_PARPORT_PC=y
CONFIG_PARPORT_SERIAL=y
CONFIG_PARTITION_ADVANCED=y
CONFIG_PATA_ATIIXP=y
CONFIG_PATA_PCMCIA=m
CONFIG_PATA_TIMINGS=y
CONFIG_PCCARD=m
CONFIG_PCCARD_NONSTATIC=y
CONFIG_PCI_DOE=y
CONFIG_PCI_DOMAINS_GENERIC=y
CONFIG_PCI_ECAM=y
CONFIG_PCI_HOST_COMMON=y
CONFIG_PCI_HOST_GENERIC=y
CONFIG_PCI_LABEL=y
CONFIG_PCI_LOONGSON=y
CONFIG_PCI_MSI_ARCH_FALLBACKS=y
CONFIG_PCI_P2PDMA=y
CONFIG_PCI_SW_SWITCHTEC=m
CONFIG_PCMCIA=m
CONFIG_PCMCIA_LOAD_CIS=y
CONFIG_PCS_XPCS=y
CONFIG_PERF_USE_VMALLOC=y
CONFIG_PGTABLE_3LEVEL=y
CONFIG_PGTABLE_LEVELS=3
CONFIG_PHYLIB_LEDS=y
CONFIG_PINCTRL_LOONGSON2=y
CONFIG_PNP=y
CONFIG_PNPACPI=y
CONFIG_PNP_DEBUG_MESSAGES=y
CONFIG_POWER_RESET_RESTART=y
CONFIG_PPPOE_HASH_BITS=4
CONFIG_PREEMPT_BUILD=y
CONFIG_PRINTK_TIME=y
CONFIG_PTP_1588_CLOCK_OPTIONAL=y
CONFIG_PWM_AXI_PWMGEN=m
CONFIG_PWM_LOONGSON=m
CONFIG_QEDF=m
CONFIG_QUEUED_RWLOCKS=y
CONFIG_QUEUED_SPINLOCKS=y
CONFIG_RADIO_ADAPTERS=m
CONFIG_RAID6_PQ=y
CONFIG_RAID6_PQ_BENCHMARK=y
CONFIG_RANDOMIZE_BASE=y
CONFIG_RANDOMIZE_BASE_MAX_OFFSET=0x01000000
CONFIG_RANDOMIZE_KSTACK_OFFSET_DEFAULT=y
CONFIG_RAPIDIO=y
CONFIG_RAPIDIO_CHMAN=m
CONFIG_RAPIDIO_ENABLE_RX_TX_PORTS=y
CONFIG_RAPIDIO_ENUM_BASIC=m
CONFIG_RAPIDIO_MPORT_CDEV=m
CONFIG_RAPIDIO_TSI721=y
CONFIG_RCU_CPU_STALL_TIMEOUT=21
CONFIG_RCU_TRACE=y
CONFIG_RD_BZIP2=y
CONFIG_RD_LZ4=y
CONFIG_RD_LZMA=y
CONFIG_RD_LZO=y
CONFIG_REBOOT_MODE=y
CONFIG_REGMAP_I2C=m
CONFIG_REGMAP_SPI=m
CONFIG_RELOCATABLE=y
CONFIG_RIONET=m
CONFIG_RIONET_RX_SIZE=128
CONFIG_RIONET_TX_SIZE=128
CONFIG_ROOT_NFS=y
CONFIG_RTC_DRV_EFI=y
CONFIG_RTC_DRV_LOONGSON=y
CONFIG_RTC_I2C_AND_SPI=y
CONFIG_RTC_INTF_PROC=y
CONFIG_RTW88_8723DE=m
CONFIG_RTW89_8852A=m
CONFIG_RTW89_8852C=m
CONFIG_RTW89_CORE=m
CONFIG_RTW89_PCI=m
CONFIG_RT_GROUP_SCHED=y
CONFIG_RUNTIME_TESTING_MENU=y
CONFIG_RXKAD=y
CONFIG_RXPERF=m
CONFIG_SCHED_MM_CID=y
CONFIG_SCHED_OMIT_FRAME_POINTER=y
CONFIG_SCSI_COMMON=y
CONFIG_SCSI_LPFC=m
CONFIG_SCSI_MVSAS_TASKLET=y
CONFIG_SCSI_PROC_FS=y
CONFIG_SCSI_QLA_FC=m
CONFIG_SCSI_QLA_ISCSI=m
CONFIG_SCSI_QLOGIC_1280=m
CONFIG_SCTP_DEFAULT_COOKIE_HMAC_MD5=y
CONFIG_SECURITY_IPE=y
CONFIG_SECURITY_NETWORK=y
CONFIG_SECURITY_PATH=y
CONFIG_SELECT_MEMORY_MODEL=y
CONFIG_SERIAL_8250=y
CONFIG_SERIAL_8250_16550A_VARIANTS=y
CONFIG_SERIAL_8250_CONSOLE=y
CONFIG_SERIAL_8250_DEPRECATED_OPTIONS=y
CONFIG_SERIAL_8250_EXAR=y
CONFIG_SERIAL_8250_NR_UARTS=16
CONFIG_SERIAL_8250_PCI=y
CONFIG_SERIAL_8250_PCILIB=y
CONFIG_SERIAL_8250_PNP=y
CONFIG_SERIAL_CORE_CONSOLE=y
CONFIG_SERIAL_EARLYCON=y
CONFIG_SERIAL_MCTRL_GPIO=y
CONFIG_SERIAL_NONSTANDARD=y
CONFIG_SERIAL_OF_PLATFORM=y
CONFIG_SERIO_I8042=y
CONFIG_SLAB_MERGE_DEFAULT=y
CONFIG_SLUB_DEBUG=y
CONFIG_SND_BT87X=m
CONFIG_SND_BT87X_OVERCLOCK=y
CONFIG_SND_CTL_LED=y
CONFIG_SND_HDA_CODEC_CONEXANT=y
CONFIG_SND_HDA_CODEC_REALTEK=y
CONFIG_SND_HDA_CODEC_SIGMATEL=y
CONFIG_SND_HDA_GENERIC_LEDS=y
CONFIG_SND_HDA_HWDEP=y
CONFIG_SND_HDA_INPUT_BEEP=y
CONFIG_SND_HDA_INPUT_BEEP_MODE=1
CONFIG_SND_HDA_INTEL=y
CONFIG_SND_HDA_PATCH_LOADER=y
CONFIG_SND_HDA_PREALLOC_SIZE=64
CONFIG_SND_HDA_RECONFIG=y
CONFIG_SND_INTEL_DSP_CONFIG=y
CONFIG_SND_INTEL_NHLT=y
CONFIG_SND_INTEL_SOUNDWIRE_ACPI=y
CONFIG_SND_PCI=y
CONFIG_SND_PCMCIA=y
CONFIG_SND_SOC_LOONGSON_CARD=m
CONFIG_SND_SOC_LOONGSON_I2S_PCI=m
CONFIG_SOCK_CGROUP_DATA=y
CONFIG_SPARSEMEM_EXTREME=y
CONFIG_SPARSEMEM_MANUAL=y
CONFIG_SPARSEMEM_VMEMMAP=y
CONFIG_SPARSEMEM_VMEMMAP_ENABLE=y
CONFIG_SPI_LOONGSON_CORE=m
CONFIG_SPI_LOONGSON_PCI=m
CONFIG_SPI_LOONGSON_PLATFORM=m
CONFIG_SQUASHFS_COMPILE_DECOMP_SINGLE=y
CONFIG_SSB_DRIVER_GPIO=y
CONFIG_STACKDEPOT=y
CONFIG_STACKDEPOT_MAX_FRAMES=64
CONFIG_STACKTRACE=y
CONFIG_STANDALONE=y
CONFIG_SYSCON_REBOOT_MODE=y
CONFIG_SYSCTL_ARCH_UNALIGN_ALLOW=y
CONFIG_SYSCTL_ARCH_UNALIGN_NO_WARN=y
CONFIG_SYSCTL_EXCEPTION_TRACE=y
CONFIG_SYSFB=y
CONFIG_SYSFS_SYSCALL=y
CONFIG_TARGET_CORE=m
CONFIG_TCM_FILEIO=m
CONFIG_TCM_IBLOCK=m
CONFIG_TCM_PSCSI=m
CONFIG_TCM_QLA2XXX=m
CONFIG_TCM_USER2=m
CONFIG_THERMAL_EMERGENCY_POWEROFF_DELAY_MS=0
CONFIG_THERMAL_GOV_POWER_ALLOCATOR=y
CONFIG_TICK_CPU_ACCOUNTING=y
CONFIG_TRACE_CLOCK=y
CONFIG_TYPEC=m
CONFIG_UCLAMP_BUCKETS_COUNT=5
CONFIG_UCS2_STRING=y
CONFIG_UDMABUF=y
CONFIG_UEVENT_HELPER=y
CONFIG_UEVENT_HELPER_PATH=""
CONFIG_UIO_DMEM_GENIRQ=m
CONFIG_UIO_PCI_GENERIC=m
CONFIG_UIO_PDRV_GENIRQ=m
CONFIG_UNIXWARE_DISKLABEL=y
CONFIG_UNWINDER_ORC=y
CONFIG_USB=y
CONFIG_USB4_NET=m
CONFIG_USB_COMMON=y
CONFIG_USB_DWC2=y
CONFIG_USB_DWC2_HOST=y
CONFIG_USB_EHCI_HCD=y
CONFIG_USB_EHCI_HCD_PLATFORM=y
CONFIG_USB_EHCI_PCI=y
CONFIG_USB_NET_DRIVERS=y
CONFIG_USB_OHCI_HCD=y
CONFIG_USB_OHCI_HCD_PCI=y
CONFIG_USB_OHCI_HCD_PLATFORM=y
CONFIG_USB_PCI_AMD=y
CONFIG_USB_ROLE_SWITCH=y
CONFIG_USB_UAS=m
CONFIG_USB_USBIO=m
CONFIG_USER_STACKTRACE_SUPPORT=y
CONFIG_USE_PERCPU_NUMA_NODE_ID=y
CONFIG_UVC_COMMON=m
CONFIG_U_SERIAL_CONSOLE=y
CONFIG_V4L2_ASYNC=m
CONFIG_VFIO_PCI_CORE=m
CONFIG_VGA_ARB_MAX_GPUS=16
CONFIG_VHOST_SCSI=m
CONFIG_VHOST_TASK=y
CONFIG_VIDEO_CMDLINE=y
CONFIG_VIDEO_NOMODESET=y
CONFIG_VIRTIO_ANCHOR=y
CONFIG_VIRTIO_PCI_LIB=y
CONFIG_VIRTIO_PCI_LIB_LEGACY=y
CONFIG_VIRTUALIZATION=y
CONFIG_VXLAN=y
CONFIG_WEXT_CORE=y
CONFIG_WEXT_PROC=y
CONFIG_XARRAY_MULTI=y
CONFIG_XOR_BLOCKS=y
CONFIG_XZ_DEC_POWERPC=y
CONFIG_XZ_DEC_SPARC=y
CONFIG_YENTA=m
CONFIG_YENTA_ENE_TUNE=y
CONFIG_YENTA_O2=y
CONFIG_YENTA_RICOH=y
CONFIG_YENTA_TI=y
CONFIG_YENTA_TOSHIBA=y
CONFIG_ZONE_DEVICE=y
CONFIG_ZONE_DMA32=y
CONFIG_ZPOOL=y
CONFIG_ZRAM_DEF_COMP="zstd"
CONFIG_ZSTD_COMMON=y
```
