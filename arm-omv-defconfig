## powerpc-omv-defconfig
```kconfig
CONFIG_64BIT=y
CONFIG_ADB_PMU=y
CONFIG_ADB_PMU_EVENT=y
CONFIG_ALLOW_DEV_COREDUMP=y
CONFIG_ALTIVEC=y
CONFIG_APERTURE_HELPERS=y
CONFIG_ARCH_CPU_PROBE_RELEASE=y
CONFIG_ARCH_DISABLE_KASAN_INLINE=y
CONFIG_ARCH_DMA_DEFAULT_COHERENT=y
CONFIG_ARCH_ENABLE_HUGEPAGE_MIGRATION=y
CONFIG_ARCH_ENABLE_MEMORY_HOTPLUG=y
CONFIG_ARCH_ENABLE_MEMORY_HOTREMOVE=y
CONFIG_ARCH_ENABLE_SPLIT_PMD_PTLOCK=y
CONFIG_ARCH_ENABLE_THP_MIGRATION=y
CONFIG_ARCH_FORCE_MAX_ORDER=8
CONFIG_ARCH_HAS_ADD_PAGES=y
CONFIG_ARCH_HAS_CC_PLATFORM=y
CONFIG_ARCH_HAS_COPY_MC=y
CONFIG_ARCH_HAS_CURRENT_STACK_POINTER=y
CONFIG_ARCH_HAS_DEBUG_VIRTUAL=y
CONFIG_ARCH_HAS_DEBUG_VM_PGTABLE=y
CONFIG_ARCH_HAS_DEBUG_WX=y
CONFIG_ARCH_HAS_DEVMEM_IS_ALLOWED=y
CONFIG_ARCH_HAS_DMA_MAP_DIRECT=y
CONFIG_ARCH_HAS_FORCE_DMA_UNENCRYPTED=y
CONFIG_ARCH_HAS_HUGEPD=y
CONFIG_ARCH_HAS_KCOV=y
CONFIG_ARCH_HAS_MEMBARRIER_CALLBACKS=y
CONFIG_ARCH_HAS_MEMREMAP_COMPAT_ALIGN=y
CONFIG_ARCH_HAS_MEM_ENCRYPT=y
CONFIG_ARCH_HAS_MMIOWB=y
CONFIG_ARCH_HAS_PHYS_TO_DMA=y
CONFIG_ARCH_HAS_PKEYS=y
CONFIG_ARCH_HAS_PMEM_API=y
CONFIG_ARCH_HAS_PTE_DEVMAP=y
CONFIG_ARCH_HAS_TICK_BROADCAST=y
CONFIG_ARCH_HAS_UACCESS_FLUSHCACHE=y
CONFIG_ARCH_HAS_UBSAN_SANITIZE_ALL=y
CONFIG_ARCH_HAVE_NMI_SAFE_CMPXCHG=y
CONFIG_ARCH_KEEP_MEMBLOCK=y
CONFIG_ARCH_MAY_HAVE_PC_FDC=y
CONFIG_ARCH_MEMORY_PROBE=y
CONFIG_ARCH_MHP_MEMMAP_ON_MEMORY_ENABLE=y
CONFIG_ARCH_MIGHT_HAVE_PC_PARPORT=y
CONFIG_ARCH_MIGHT_HAVE_PC_SERIO=y
CONFIG_ARCH_MMAP_RND_BITS=14
CONFIG_ARCH_MMAP_RND_BITS_MAX=29
CONFIG_ARCH_MMAP_RND_BITS_MIN=14
CONFIG_ARCH_MMAP_RND_COMPAT_BITS=7
CONFIG_ARCH_MMAP_RND_COMPAT_BITS_MAX=13
CONFIG_ARCH_MMAP_RND_COMPAT_BITS_MIN=7
CONFIG_ARCH_OPTIONAL_KERNEL_RWX=y
CONFIG_ARCH_OPTIONAL_KERNEL_RWX_DEFAULT=y
CONFIG_ARCH_SELECTS_CRASH_DUMP=y
CONFIG_ARCH_SELECTS_KEXEC_FILE=y
CONFIG_ARCH_SELECT_MEMORY_MODEL=y
CONFIG_ARCH_SPARSEMEM_DEFAULT=y
CONFIG_ARCH_STACKWALK=y
CONFIG_ARCH_SUPPORTS_CRASH_DUMP=y
CONFIG_ARCH_SUPPORTS_DEBUG_PAGEALLOC=y
CONFIG_ARCH_SUPPORTS_KEXEC=y
CONFIG_ARCH_SUPPORTS_KEXEC_FILE=y
CONFIG_ARCH_SUPPORTS_KEXEC_PURGATORY=y
CONFIG_ARCH_SUPPORTS_MEMORY_FAILURE=y
CONFIG_ARCH_SUPPORTS_NUMA_BALANCING=y
CONFIG_ARCH_SUPPORTS_PER_VMA_LOCK=y
CONFIG_ARCH_SUSPEND_NONZERO_CPU=y
CONFIG_ARCH_USES_HIGH_VMA_FLAGS=y
CONFIG_ARCH_USE_BUILTIN_BSWAP=y
CONFIG_ARCH_USE_CMPXCHG_LOCKREF=y
CONFIG_ARCH_USE_MEMTEST=y
CONFIG_ARCH_USE_QUEUED_RWLOCKS=y
CONFIG_ARCH_WANTS_FREEZER_CONTROL=y
CONFIG_ARCH_WANT_COMPAT_IPC_PARSE_VERSION=y
CONFIG_ARCH_WANT_DEFAULT_BPF_JIT=y
CONFIG_ARCH_WANT_DEFAULT_TOPDOWN_MMAP_LAYOUT=y
CONFIG_ARCH_WANT_IPC_PARSE_VERSION=y
CONFIG_ARCH_WANT_IRQS_OFF_ACTIVATE_MM=y
CONFIG_ARCH_WANT_LD_ORPHAN_WARN=y
CONFIG_ARCH_WANT_OLD_COMPAT_IPC=y
CONFIG_ARCH_WANT_OPTIMIZE_DAX_VMEMMAP=y
CONFIG_ARCH_WANT_PMD_MKWRITE=y
CONFIG_ARCH_WEAK_RELEASE_ACQUIRE=y
CONFIG_ASYNC_RAID6_TEST=m
CONFIG_ATA_FORCE=y
CONFIG_ATA_GENERIC=y
CONFIG_ATA_NONSTANDARD=y
CONFIG_ATA_VERBOSE_ERROR=y
CONFIG_ATOMIC64_SELFTEST=m
CONFIG_AUDIT=y
CONFIG_AUDITSYSCALL=y
CONFIG_AUDIT_ARCH=y
CONFIG_AUXILIARY_BUS=y
CONFIG_AXON_MSI=y
CONFIG_BACKTRACE_SELF_TEST=m
CONFIG_BATTERY_BQ27XXX=m
CONFIG_BATTERY_BQ27XXX_DT_UPDATES_NVM=y
CONFIG_BATTERY_CW2015=m
CONFIG_BATTERY_DS2760=m
CONFIG_BATTERY_DS2780=m
CONFIG_BATTERY_DS2781=m
CONFIG_BATTERY_DS2782=m
CONFIG_BATTERY_GAUGE_LTC2941=m
CONFIG_BATTERY_MAX17042=m
CONFIG_BATTERY_MAX1721X=m
CONFIG_BATTERY_SAMSUNG_SDI=y
CONFIG_BATTERY_SBS=m
CONFIG_BCM_NET_PHYLIB=m
CONFIG_BITFIELD_KUNIT=m
CONFIG_BITS_TEST=m
CONFIG_BLK_CGROUP_PUNT_BIO=y
CONFIG_BLK_DEBUG_FS=y
CONFIG_BLK_DEV_BSG_COMMON=y
CONFIG_BLK_DEV_FD=y
CONFIG_BLK_DEV_IO_TRACE=y
CONFIG_BLK_DEV_PMEM=y
CONFIG_BLK_DEV_RAM=y
CONFIG_BLK_DEV_RAM_SIZE=65536
CONFIG_BLK_DEV_SD=y
CONFIG_BLK_DEV_SR=y
CONFIG_BLK_MQ_STACKING=y
CONFIG_BLOCK_HOLDER_DEPRECATED=y
CONFIG_BOOTX_TEXT=y
CONFIG_BPF_EVENTS=y
CONFIG_BPF_UNPRIV_DEFAULT_OFF=y
CONFIG_BRANCH_PROFILE_NONE=y
CONFIG_BROADCOM_PHY=m
CONFIG_BSD_PROCESS_ACCT_V3=y
CONFIG_BTT=y
CONFIG_BUG=y
CONFIG_BUG_ON_DATA_CORRUPTION=y
CONFIG_CARDBUS=y
CONFIG_CBE_CPUFREQ_SPU_GOVERNOR=m
CONFIG_CBE_RAS=y
CONFIG_CBE_THERM=m
CONFIG_CC_IMPLICIT_FALLTHROUGH="-Wimplicit-fallthrough=5"
CONFIG_CC_NO_ARRAY_BOUNDS=y
CONFIG_CC_OPTIMIZE_FOR_PERFORMANCE=y
CONFIG_CDROM=y
CONFIG_CHARGER_BD99954=m
CONFIG_CHARGER_BQ2415X=m
CONFIG_CHARGER_BQ24257=m
CONFIG_CHARGER_BQ25890=m
CONFIG_CHARGER_GPIO=m
CONFIG_CHARGER_LP8727=m
CONFIG_CHARGER_LT3651=m
CONFIG_CHARGER_MAX8903=m
CONFIG_CHARGER_RT9455=m
CONFIG_CHARGER_SBS=m
CONFIG_CHECKSUM_KUNIT=m
CONFIG_CLKBLD_I8253=y
CONFIG_CLONE_BACKWARDS=y
CONFIG_CMA_AREAS=19
CONFIG_CMDLINE=""
CONFIG_CMDLINE_KUNIT_TEST=m
CONFIG_CMM=y
CONFIG_CODE_PATCHING_SELFTEST=y
CONFIG_COMPACT_UNEVICTABLE_DEFAULT=1
CONFIG_COMPAT=y
CONFIG_COMPAT_BINFMT_ELF=y
CONFIG_COMPAT_OLD_SIGACTION=y
CONFIG_CONTEXT_SWITCH_TRACER=y
CONFIG_CONTEXT_TRACKING=y
CONFIG_CONTEXT_TRACKING_IDLE=y
CONFIG_CONTEXT_TRACKING_USER=y
CONFIG_CORE_DUMP_DEFAULT_ELF_HEADERS=y
CONFIG_CPUMASK_KUNIT_TEST=m
CONFIG_CPU_BIG_ENDIAN=y
CONFIG_CPU_FREQ_CBE=m
CONFIG_CPU_FREQ_DEFAULT_GOV_ONDEMAND=y
CONFIG_CPU_FREQ_GOV_CONSERVATIVE=y
CONFIG_CPU_FREQ_GOV_POWERSAVE=y
CONFIG_CPU_FREQ_PMAC64=y
CONFIG_CRASH_CORE=y
CONFIG_CRASH_DUMP=y
CONFIG_CRASH_HOTPLUG=y
CONFIG_CRASH_MAX_MEMORY_RANGES=8192
CONFIG_CRC16=y
CONFIG_CRC_BENCHMARK=y
CONFIG_CRC_ITU_T=m
CONFIG_CRC_KUNIT_TEST=m
CONFIG_CRYPTO_AEAD=m
CONFIG_CRYPTO_CRC32C=y
CONFIG_CRYPTO_CRC32C_VPMSUM=m
CONFIG_CRYPTO_CRC64_ROCKSOFT=m
CONFIG_CRYPTO_CRCT10DIF_VPMSUM=m
CONFIG_CRYPTO_CTR=m
CONFIG_CRYPTO_DEV_NX=y
CONFIG_CRYPTO_DEV_NX_COMPRESS=y
CONFIG_CRYPTO_DEV_NX_COMPRESS_POWERNV=y
CONFIG_CRYPTO_DEV_NX_COMPRESS_PSERIES=y
CONFIG_CRYPTO_DEV_NX_ENCRYPT=m
CONFIG_CRYPTO_DEV_VMX=y
CONFIG_CRYPTO_DEV_VMX_ENCRYPT=m
CONFIG_CRYPTO_DRBG=m
CONFIG_CRYPTO_DRBG_MENU=m
CONFIG_CRYPTO_ECHAINIV=m
CONFIG_CRYPTO_GENIV=m
CONFIG_CRYPTO_JITTERENTROPY=m
CONFIG_CRYPTO_LIB_BENCHMARK=y
CONFIG_CRYPTO_LIB_GF128MUL=m
CONFIG_CRYPTO_LIB_POLY1305_KUNIT_TEST=m
CONFIG_CRYPTO_LIB_POLY1305_RSIZE=1
CONFIG_CRYPTO_LIB_SHA1=y
CONFIG_CRYPTO_LIB_SHA1_KUNIT_TEST=m
CONFIG_CRYPTO_LIB_SHA256_KUNIT_TEST=m
CONFIG_CRYPTO_LIB_SHA512_KUNIT_TEST=m
CONFIG_CRYPTO_LIB_UTILS=y
CONFIG_CRYPTO_LZO=y
CONFIG_CRYPTO_MD5_PPC=m
CONFIG_CRYPTO_NULL=m
CONFIG_CRYPTO_NULL2=m
CONFIG_CRYPTO_RNG=m
CONFIG_CRYPTO_RNG_DEFAULT=m
CONFIG_CRYPTO_SHA1_PPC=m
CONFIG_CRYPTO_SHA3=m
CONFIG_CRYPTO_SIG2=y
CONFIG_CRYPTO_VPMSUM_TESTER=m
CONFIG_CRYPTO_XTS=m
CONFIG_CXL=m
CONFIG_CXLFLASH=m
CONFIG_CXL_BASE=y
CONFIG_DATA_SHIFT=24
CONFIG_DEBUGGER=y
CONFIG_DEBUG_BUGVERBOSE=y
CONFIG_DEBUG_FS_ALLOW_ALL=y
CONFIG_DEBUG_MEMORY_INIT=y
CONFIG_DEBUG_MISC=y
CONFIG_DEBUG_MUTEXES=y
CONFIG_DEBUG_RODATA_TEST=y
CONFIG_DEBUG_STACKOVERFLOW=y
CONFIG_DEBUG_STACK_USAGE=y
CONFIG_DEBUG_VM=y
CONFIG_DEBUG_VM_IRQSOFF=y
CONFIG_DECOMPRESS_BZIP2=y
CONFIG_DECOMPRESS_LZ4=y
CONFIG_DECOMPRESS_LZMA=y
CONFIG_DECOMPRESS_LZO=y
CONFIG_DEFAULT_HOSTNAME="(none)"
CONFIG_DEFAULT_HUNG_TASK_TIMEOUT=120
CONFIG_DEFAULT_MMAP_MIN_ADDR=4096
CONFIG_DEFAULT_SECURITY_SELINUX=y
CONFIG_DETECT_HUNG_TASK=y
CONFIG_DEVICE_MIGRATION=y
CONFIG_DMA_DECLARE_COHERENT=y
CONFIG_DMA_OPS_BYPASS=y
CONFIG_DM_DELAY=m
CONFIG_DM_DUST=m
CONFIG_DM_EBS=m
CONFIG_DM_INIT=y
CONFIG_DM_MULTIPATH_HST=m
CONFIG_DTC=y
CONFIG_DTL=y
CONFIG_DYNAMIC_EVENTS=y
CONFIG_DYNAMIC_FTRACE=y
CONFIG_EARLY_PRINTK=y
CONFIG_EDAC=y
CONFIG_EDAC_ATOMIC_SCRUB=y
CONFIG_EDAC_PASEMI=y
CONFIG_EEH=y
CONFIG_EHEA=m
CONFIG_ELECTRA_CF=y
CONFIG_EPAPR_BOOT=y
CONFIG_EPROBE_EVENTS=y
CONFIG_EVENT_TRACING=y
CONFIG_EXCLUSIVE_SYSTEM_RAM=y
CONFIG_EXTRA_TARGETS=""
CONFIG_FAILOVER=m
CONFIG_FA_DUMP=y
CONFIG_FB_CORE=y
CONFIG_FB_DDC=y
CONFIG_FB_DEVICE=y
CONFIG_FB_IBM_GXT4500=y
CONFIG_FB_IOMEM_HELPERS=y
CONFIG_FB_LOGO_EXTRA=y
CONFIG_FB_MACMODES=y
CONFIG_FB_MATROX=y
CONFIG_FB_MATROX_G=y
CONFIG_FB_MATROX_I2C=m
CONFIG_FB_MATROX_MAVEN=m
CONFIG_FB_MATROX_MILLENIUM=y
CONFIG_FB_MATROX_MYSTIQUE=y
CONFIG_FB_OF=y
CONFIG_FB_PS3=m
CONFIG_FB_PS3_DEFAULT_SIZE_M=9
CONFIG_FB_RADEON=y
CONFIG_FB_RADEON_BACKLIGHT=y
CONFIG_FB_RADEON_I2C=y
CONFIG_FB_SYS_COPYAREA=m
CONFIG_FB_SYS_FILLRECT=m
CONFIG_FB_SYS_FOPS=m
CONFIG_FB_SYS_IMAGEBLIT=m
CONFIG_FB_TILEBLITTING=y
CONFIG_FIND_BIT_BENCHMARK=m
CONFIG_FIRMWARE_EDID=y
CONFIG_FORCE_PCI=y
CONFIG_FORCE_SMP=y
CONFIG_FTRACE=y
CONFIG_FTRACE_MCOUNT_RECORD=y
CONFIG_FTRACE_MCOUNT_USE_CC=y
CONFIG_FTRACE_SYSCALLS=y
CONFIG_FTR_FIXUP_SELFTEST=y
CONFIG_FUNCTION_ALIGNMENT=0
CONFIG_FUNCTION_GRAPH_RETVAL=y
CONFIG_FUNCTION_GRAPH_TRACER=y
CONFIG_FWNODE_MDIO=y
CONFIG_FW_CS_DSP_KUNIT_TEST=m
CONFIG_GCC11_NO_ARRAY_BOUNDS=y
CONFIG_GELIC_NET=m
CONFIG_GELIC_WIRELESS=y
CONFIG_GENERIC_BUG=y
CONFIG_GENERIC_BUG_RELATIVE_POINTERS=y
CONFIG_GENERIC_CMOS_UPDATE=y
CONFIG_GENERIC_CPU_VULNERABILITIES=y
CONFIG_GENERIC_HWEIGHT=y
CONFIG_GENERIC_IDLE_POLL_SETUP=y
CONFIG_GENERIC_IOMAP=y
CONFIG_GENERIC_IOREMAP=y
CONFIG_GENERIC_IRQ_SHOW_LEVEL=y
CONFIG_GENERIC_ISA_DMA=y
CONFIG_GENERIC_PTDUMP=y
CONFIG_GENERIC_TBSYNC=y
CONFIG_GENERIC_TRACER=y
CONFIG_GENERIC_VDSO_TIME_NS=y
CONFIG_HARDLOCKUP_DETECTOR=y
CONFIG_HARDLOCKUP_DETECTOR_ARCH=y
CONFIG_HASHTABLE_KUNIT_TEST=m
CONFIG_HASH_KUNIT_TEST=m
CONFIG_HAS_IOPORT=y
CONFIG_HAS_IOPORT_MAP=y
CONFIG_HIBERNATION_LZO=y
CONFIG_HOTPLUG_PCI_RPA=m
CONFIG_HOTPLUG_PCI_RPA_DLPAR=m
CONFIG_HOTPLUG_SMT=y
CONFIG_HTMDUMP=m
CONFIG_HUGETLB_PAGE_SIZE_VARIABLE=y
CONFIG_HVCS=m
CONFIG_HVC_CONSOLE=y
CONFIG_HVC_IRQ=y
CONFIG_HVC_OPAL=y
CONFIG_HVC_RTAS=y
CONFIG_HV_PERF_CTRS=y
CONFIG_HW_RANDOM=m
CONFIG_HW_RANDOM_AMD=m
CONFIG_HW_RANDOM_PASEMI=m
CONFIG_HW_RANDOM_POWERNV=m
CONFIG_HW_RANDOM_PSERIES=m
CONFIG_HZ=100
CONFIG_HZ_100=y
CONFIG_I2C=y
CONFIG_I2C_ALGOBIT=y
CONFIG_I2C_AMD8111=y
CONFIG_I2C_CHARDEV=y
CONFIG_I2C_DESIGNWARE_CORE=m
CONFIG_I2C_DESIGNWARE_SLAVE=y
CONFIG_I2C_OPAL=y
CONFIG_I2C_PASEMI=y
CONFIG_I2C_POWERMAC=y
CONFIG_I2C_SLAVE_EEPROM=m
CONFIG_I8253_LOCK=y
CONFIG_IBMEBUS=y
CONFIG_IBMVETH=m
CONFIG_IBMVIO=y
CONFIG_IBMVNIC=m
CONFIG_IBM_BSR=m
CONFIG_ILLEGAL_POINTER_VALUE=0x5deadbeef0000000
CONFIG_IMA=y
CONFIG_IMA_APPRAISE=y
CONFIG_IMA_APPRAISE_BOOTPARAM=y
CONFIG_IMA_APPRAISE_MODSIG=y
CONFIG_IMA_ARCH_POLICY=y
CONFIG_IMA_DEFAULT_HASH="sha256"
CONFIG_IMA_DEFAULT_HASH_SHA256=y
CONFIG_IMA_DEFAULT_TEMPLATE="ima-ng"
CONFIG_IMA_KEXEC=y
CONFIG_IMA_KEXEC_EXTRA_MEMORY_KB=0
CONFIG_IMA_LSM_RULES=y
CONFIG_IMA_MEASURE_ASYMMETRIC_KEYS=y
CONFIG_IMA_MEASURE_PCR_IDX=10
CONFIG_IMA_NG_TEMPLATE=y
CONFIG_IMA_QUEUE_EARLY_BOOT_KEYS=y
CONFIG_IMA_READ_POLICY=y
CONFIG_IMA_SECURE_AND_OR_TRUSTED_BOOT=y
CONFIG_IMA_WRITE_POLICY=y
CONFIG_INFINIBAND_BNXT_RE=m
CONFIG_INFINIBAND_IONIC=m
CONFIG_INFINIBAND_IPOIB_DEBUG=y
CONFIG_INFINIBAND_MTHCA_DEBUG=y
CONFIG_INFINIBAND_VIRT_DMA=y
CONFIG_INLINE_READ_UNLOCK=y
CONFIG_INLINE_READ_UNLOCK_IRQ=y
CONFIG_INLINE_SPIN_UNLOCK_IRQ=y
CONFIG_INLINE_WRITE_UNLOCK=y
CONFIG_INLINE_WRITE_UNLOCK_IRQ=y
CONFIG_INPUT_EVDEV=m
CONFIG_INPUT_KUNIT_TEST=m
CONFIG_INPUT_MOUSE=y
CONFIG_INPUT_PCSPKR=m
CONFIG_INPUT_VIVALDIFMAP=y
CONFIG_INTEGRITY=y
CONFIG_INTEGRITY_ASYMMETRIC_KEYS=y
CONFIG_INTEGRITY_AUDIT=y
CONFIG_INTEGRITY_PLATFORM_KEYRING=y
CONFIG_INTEGRITY_SIGNATURE=y
CONFIG_INTEGRITY_TRUSTED_KEYRING=y
CONFIG_INTERVAL_TREE_TEST=m
CONFIG_INT_SQRT_KUNIT_TEST=m
CONFIG_IOMMU_DEFAULT_DMA_STRICT=y
CONFIG_IOMMU_HELPER=y
CONFIG_IO_EVENT_IRQ=y
CONFIG_IO_STRICT_DEVMEM=y
CONFIG_IPE_BOOT_POLICY=""
CONFIG_IPE_POLICY_SIG_PLATFORM_KEYRING=y
CONFIG_IRQCHIP=y
CONFIG_IRQ_ALL_CPUS=y
CONFIG_IRQ_BYPASS_MANAGER=y
CONFIG_IRQ_DOMAIN_NOMAP=y
CONFIG_IRQ_EDGE_EOI_HANDLER=y
CONFIG_ISA_DMA_API=y
CONFIG_IS_SIGNED_TYPE_KUNIT_TEST=m
CONFIG_JUMP_LABEL_FEATURE_CHECKS=y
CONFIG_KCMP=y
CONFIG_KERNEL_GZIP=y
CONFIG_KERNEL_START=0xc000000000000000
CONFIG_KEXEC=y
CONFIG_KEXEC_CORE=y
CONFIG_KEXEC_ELF=y
CONFIG_KEXEC_FILE=y
CONFIG_KEXEC_HANDOVER=y
CONFIG_KPROBES_SANITY_TEST=m
CONFIG_KPROBE_EVENTS=y
CONFIG_KUNIT=m
CONFIG_KUNIT_ALL_TESTS=m
CONFIG_KUNIT_AUTORUN_ENABLED=y
CONFIG_KUNIT_DEBUGFS=y
CONFIG_KUNIT_DEFAULT_ENABLED=y
CONFIG_KUNIT_DEFAULT_TIMEOUT=300
CONFIG_KUNIT_EXAMPLE_TEST=m
CONFIG_KUNIT_TEST=m
CONFIG_KVM=y
CONFIG_KVM_BOOK3S_64=m
CONFIG_KVM_BOOK3S_64_HANDLER=y
CONFIG_KVM_BOOK3S_64_HV=m
CONFIG_KVM_BOOK3S_HANDLER=y
CONFIG_KVM_BOOK3S_HV_NESTED_PMU_WORKAROUND=y
CONFIG_KVM_BOOK3S_HV_POSSIBLE=y
CONFIG_KVM_COMPAT=y
CONFIG_KVM_VFIO=y
CONFIG_KVM_XICS=y
CONFIG_KVM_XIVE=y
CONFIG_LEDS_POWERNV=m
CONFIG_LEDS_TRIGGER_ACTIVITY=m
CONFIG_LEDS_TRIGGER_DEFAULT_ON=m
CONFIG_LEDS_TRIGGER_HEARTBEAT=m
CONFIG_LEGACY_PTYS=y
CONFIG_LEGACY_PTY_COUNT=256
CONFIG_LEGACY_TIOCSTI=y
CONFIG_LIBCRC32C=y
CONFIG_LIBFDT=y
CONFIG_LIBNVDIMM=y
CONFIG_LINEAR_RANGES=m
CONFIG_LINEAR_RANGES_TEST=m
CONFIG_LIST_HARDENED=y
CONFIG_LIST_KUNIT_TEST=m
CONFIG_LKDTM=m
CONFIG_LOAD_PPC_KEYS=y
CONFIG_LOCALVERSION_AUTO=y
CONFIG_LOCKUP_DETECTOR=y
CONFIG_LOCK_DEBUGGING_SUPPORT=y
CONFIG_LOCK_DOWN_KERNEL_FORCE_NONE=y
CONFIG_LOCK_MM_AND_FIND_VMA=y
CONFIG_LOCK_TORTURE_TEST=m
CONFIG_LOGO=y
CONFIG_LOGO_LINUX_CLUT224=y
CONFIG_LOGO_LINUX_MONO=y
CONFIG_LOGO_LINUX_VGA16=y
CONFIG_LOG_BUF_SHIFT=18
CONFIG_LOG_CPU_MAX_BUF_SHIFT=13
CONFIG_LPARCFG=y
CONFIG_LSM_MMAP_MIN_ADDR=65536
CONFIG_LTO_NONE=y
CONFIG_LZ4_DECOMPRESS=y
CONFIG_LZO_COMPRESS=y
CONFIG_LZO_DECOMPRESS=y
CONFIG_MACINTOSH_DRIVERS=y
CONFIG_MAC_PARTITION=y
CONFIG_MAGIC_SYSRQ_DEFAULT_ENABLE=0x1
CONFIG_MATH_EMULATION=y
CONFIG_MATH_EMULATION_HW_UNIMPLEMENTED=y
CONFIG_MDIO_BUS=y
CONFIG_MDIO_DEVICE=y
CONFIG_MDIO_DEVRES=y
CONFIG_MD_AUTODETECT=y
CONFIG_MD_BITMAP_FILE=y
CONFIG_MD_FAULTY=m
CONFIG_MEMCPY_KUNIT_TEST=m
CONFIG_MEMCPY_SLOW_KUNIT_TEST=y
CONFIG_MEMFD_CREATE=y
CONFIG_MEMORY_HOTPLUG=y
CONFIG_MEMORY_HOTREMOVE=y
CONFIG_MEMREGION=y
CONFIG_MFD_88PM886_PMIC=y
CONFIG_MHP_DEFAULT_ONLINE_TYPE_ONLINE_AUTO=y
CONFIG_MHP_MEMMAP_ON_MEMORY=y
CONFIG_MII=y
CONFIG_MMIOWB=y
CONFIG_MMIO_NVRAM=y
CONFIG_MMU_GATHER_MERGE_VMAS=y
CONFIG_MMU_GATHER_PAGE_SIZE=y
CONFIG_MMU_LAZY_TLB_SHOOTDOWN=y
CONFIG_MODULES_USE_ELF_RELA=y
CONFIG_MOUSE_PS2=y
CONFIG_MOUSE_PS2_ALPS=y
CONFIG_MOUSE_PS2_BYD=y
CONFIG_MOUSE_PS2_CYPRESS=y
CONFIG_MOUSE_PS2_FOCALTECH=y
CONFIG_MOUSE_PS2_LOGIPS2PP=y
CONFIG_MOUSE_PS2_PIXART=y
CONFIG_MOUSE_PS2_SMBUS=y
CONFIG_MOUSE_PS2_SYNAPTICS=y
CONFIG_MOUSE_PS2_SYNAPTICS_SMBUS=y
CONFIG_MOUSE_PS2_TRACKPOINT=y
CONFIG_MPIC=y
CONFIG_MPIC_BROKEN_REGREAD=y
CONFIG_MPIC_U3_HT_IRQS=y
CONFIG_MQ_IOSCHED_KYBER=y
CONFIG_MSI_BITMAP_SELFTEST=y
CONFIG_ND_BTT=y
CONFIG_ND_CLAIM=y
CONFIG_ND_PFN=y
CONFIG_NEED_PER_CPU_EMBED_FIRST_CHUNK=y
CONFIG_NEED_PER_CPU_PAGE_FIRST_CHUNK=y
CONFIG_NEED_SG_DMA_LENGTH=y
CONFIG_NEED_SRCU_NMI_SAFE=y
CONFIG_NETCONSOLE=y
CONFIG_NETDEV_ADDR_LIST_TEST=m
CONFIG_NET_FAILOVER=m
CONFIG_NET_SELFTESTS=y
CONFIG_NET_VENDOR_IBM=y
CONFIG_NET_VENDOR_PASEMI=y
CONFIG_NET_VENDOR_TOSHIBA=y
CONFIG_NMI_IPI=y
CONFIG_NODES_SHIFT=8
CONFIG_NONSTATIC_KERNEL=y
CONFIG_NOP_TRACER=y
CONFIG_NR_CPUS=2048
CONFIG_NR_IRQS=512
CONFIG_NUMA=y
CONFIG_NUMA_BALANCING=y
CONFIG_NUMA_BALANCING_DEFAULT_ENABLED=y
CONFIG_NUMA_KEEP_MEMINFO=y
CONFIG_NVDIMM_DAX=y
CONFIG_NVDIMM_PFN=y
CONFIG_NVRAM=y
CONFIG_OF=y
CONFIG_OF_ADDRESS=y
CONFIG_OF_DYNAMIC=y
CONFIG_OF_EARLY_FLATTREE=y
CONFIG_OF_FLATTREE=y
CONFIG_OF_IOMMU=y
CONFIG_OF_IRQ=y
CONFIG_OF_KOBJ=y
CONFIG_OF_MDIO=y
CONFIG_OF_PMEM=y
CONFIG_OF_RESERVED_MEM=y
CONFIG_OLD_SIGSUSPEND=y
CONFIG_OPTPROBES=y
CONFIG_OVERFLOW_KUNIT_TEST=m
CONFIG_PAGE_BLOCK_MAX_ORDER=8
CONFIG_PAGE_BLOCK_ORDER=8
CONFIG_PAGE_EXTENSION=y
CONFIG_PAGE_OFFSET=0xc000000000000000
CONFIG_PAGE_OWNER=y
CONFIG_PAGE_POISONING=y
CONFIG_PAGE_SIZE_64KB=y
CONFIG_PAGE_SIZE_LESS_THAN_256KB=y
CONFIG_PANIC_TIMEOUT=180
CONFIG_PAPR_SCM=m
CONFIG_PARAVIRT=y
CONFIG_PARAVIRT_SPINLOCKS=y
CONFIG_PARAVIRT_TIME_ACCOUNTING=y
CONFIG_PARTITION_ADVANCED=y
CONFIG_PASEMI_MAC=y
CONFIG_PATA_AMD=y
CONFIG_PATA_MACIO=y
CONFIG_PATA_TIMINGS=y
CONFIG_PCCARD=y
CONFIG_PCIE_XILINX_DMA_PL=y
CONFIG_PCI_DOE=y
CONFIG_PCI_MSI_ARCH_FALLBACKS=y
CONFIG_PCI_SYSCALL=y
CONFIG_PCMCIA=y
CONFIG_PCMCIA_LOAD_CIS=y
CONFIG_PCSPKR_PLATFORM=y
CONFIG_PERCPU_TEST=m
CONFIG_PER_VMA_LOCK=y
CONFIG_PGTABLE_LEVELS=4
CONFIG_PHYSICAL_START=0x00000000
CONFIG_PMAC_SMU=y
CONFIG_PM_SLEEP_SMP_NONZERO_CPU=y
CONFIG_POWERNV_CPUFREQ=y
CONFIG_POWERNV_CPUIDLE=y
CONFIG_POWERNV_OP_PANEL=m
CONFIG_POWERPC64_CPU=y
CONFIG_PPC=y
CONFIG_PPC64=y
CONFIG_PPC64_ELF_ABI_V1=y
CONFIG_PPC64_SUPPORTS_MEMORY_FAILURE=y
CONFIG_PPC_64K_PAGES=y
CONFIG_PPC_64S_HASH_MMU=y
CONFIG_PPC_970_NAP=y
CONFIG_PPC_BARRIER_NOSPEC=y
CONFIG_PPC_BOOK3S=y
CONFIG_PPC_BOOK3S_64=y
CONFIG_PPC_BOOK3S_IDLE=y
CONFIG_PPC_CELL=y
CONFIG_PPC_CELL_COMMON=y
CONFIG_PPC_CELL_NATIVE=y
CONFIG_PPC_COPRO_BASE=y
CONFIG_PPC_DAWR=y
CONFIG_PPC_DCR=y
CONFIG_PPC_DCR_MMIO=y
CONFIG_PPC_DENORMALISATION=y
CONFIG_PPC_DOORBELL=y
CONFIG_PPC_DT_CPU_FTRS=y
CONFIG_PPC_EMULATED_STATS=y
CONFIG_PPC_FPU=y
CONFIG_PPC_FPU_REGS=y
CONFIG_PPC_HASH_MMU_NATIVE=y
CONFIG_PPC_HAVE_PMU_SUPPORT=y
CONFIG_PPC_I8259=y
CONFIG_PPC_IBM_CELL_BLADE=y
CONFIG_PPC_IBM_CELL_POWERBUTTON=m
CONFIG_PPC_IBM_CELL_RESETBUTTON=y
CONFIG_PPC_ICP_HV=y
CONFIG_PPC_ICP_NATIVE=y
CONFIG_PPC_ICS_RTAS=y
CONFIG_PPC_INDIRECT_MMIO=y
CONFIG_PPC_INDIRECT_PIO=y
CONFIG_PPC_IO_WORKAROUNDS=y
CONFIG_PPC_KUAP=y
CONFIG_PPC_KUEP=y
CONFIG_PPC_MAPLE=y
CONFIG_PPC_MEM_KEYS=y
CONFIG_PPC_MICROWATT=y
CONFIG_PPC_MSI_BITMAP=y
CONFIG_PPC_OF_BOOT_TRAMPOLINE=y
CONFIG_PPC_OF_PLATFORM_PCI=y
CONFIG_PPC_P7_NAP=y
CONFIG_PPC_PAGE_SHIFT=16
CONFIG_PPC_PASEMI=y
CONFIG_PPC_PASEMI_CPUFREQ=y
CONFIG_PPC_PASEMI_IOMMU=y
CONFIG_PPC_PASEMI_MDIO=y
CONFIG_PPC_PERF_CTRS=y
CONFIG_PPC_PKEY=y
CONFIG_PPC_PMAC=y
CONFIG_PPC_PMAC64=y
CONFIG_PPC_PMI=m
CONFIG_PPC_POWERNV=y
CONFIG_PPC_PS3=y
CONFIG_PPC_PSERIES=y
CONFIG_PPC_QUEUED_SPINLOCKS=y
CONFIG_PPC_RADIX_MMU=y
CONFIG_PPC_RADIX_MMU_DEFAULT=y
CONFIG_PPC_RTAS=y
CONFIG_PPC_RTAS_DAEMON=y
CONFIG_PPC_SECURE_BOOT=y
CONFIG_PPC_SECVAR_SYSFS=y
CONFIG_PPC_SMLPAR=y
CONFIG_PPC_SMP_MUXED_IPI=y
CONFIG_PPC_SPLPAR=y
CONFIG_PPC_SVM=y
CONFIG_PPC_TRANSACTIONAL_MEM=y
CONFIG_PPC_UDBG_16550=y
CONFIG_PPC_VAS=y
CONFIG_PPC_WATCHDOG=y
CONFIG_PPC_WERROR=y
CONFIG_PPC_XICS=y
CONFIG_PPC_XIVE=y
CONFIG_PPC_XIVE_NATIVE=y
CONFIG_PPC_XIVE_SPAPR=y
CONFIG_PPPOE_HASH_BITS=4
CONFIG_PREEMPT_NOTIFIERS=y
CONFIG_PREEMPT_VOLUNTARY=y
CONFIG_PREEMPT_VOLUNTARY_BUILD=y
CONFIG_PRINTK_CALLER=y
CONFIG_PRINTK_TIME=y
CONFIG_PRINT_STACK_DEPTH=64
CONFIG_PROBE_EVENTS=y
CONFIG_PS3_DISK=m
CONFIG_PS3_FLASH=m
CONFIG_PS3_HTAB_SIZE=20
CONFIG_PS3_LPM=m
CONFIG_PS3_PS3AV=y
CONFIG_PS3_ROM=m
CONFIG_PS3_STORAGE=m
CONFIG_PS3_SYS_MANAGER=y
CONFIG_PS3_VUART=y
CONFIG_PSERIES_CPUIDLE=y
CONFIG_PSERIES_ENERGY=y
CONFIG_PSERIES_PLPKS=y
CONFIG_PTDUMP_CORE=y
CONFIG_PTP_1588_CLOCK_OPTIONAL=y
CONFIG_QUEUED_RWLOCKS=y
CONFIG_RAID6_PQ_BENCHMARK=y
CONFIG_RANDSTRUCT_KUNIT_TEST=m
CONFIG_RBTREE_TEST=m
CONFIG_RCU_TRACE=y
CONFIG_RD_BZIP2=y
CONFIG_RD_LZ4=y
CONFIG_RD_LZMA=y
CONFIG_RD_LZO=y
CONFIG_REED_SOLOMON_ENC16=y
CONFIG_REED_SOLOMON_TEST=m
CONFIG_REF_TRACKER=y
CONFIG_REGMAP_I2C=y
CONFIG_REGMAP_KUNIT=m
CONFIG_REGMAP_RAM=m
CONFIG_RELOCATABLE=y
CONFIG_RESOURCE_KUNIT_TEST=m
CONFIG_RING_BUFFER=y
CONFIG_RTAS_ERROR_LOGGING=y
CONFIG_RTAS_FLASH=m
CONFIG_RTAS_PROC=y
CONFIG_RTC_DRV_DS1307=y
CONFIG_RTC_DRV_OPAL=y
CONFIG_RTC_I2C_AND_SPI=y
CONFIG_RTC_INTF_PROC=y
CONFIG_RTC_LIB_KUNIT_TEST=m
CONFIG_RUNTIME_TESTING_MENU=y
CONFIG_RXPERF=m
CONFIG_SCHED_DEBUG=y
CONFIG_SCHED_MM_CID=y
CONFIG_SCHED_OMIT_FRAME_POINTER=y
CONFIG_SCHED_TRACER=y
CONFIG_SCSI_COMMON=y
CONFIG_SCSI_CXGB3_ISCSI=m
CONFIG_SCSI_CXGB4_ISCSI=m
CONFIG_SCSI_DH=y
CONFIG_SCSI_DH_ALUA=m
CONFIG_SCSI_DH_RDAC=m
CONFIG_SCSI_IBMVFC=m
CONFIG_SCSI_IBMVFC_TRACE=y
CONFIG_SCSI_IBMVSCSI=y
CONFIG_SCSI_IPR=y
CONFIG_SCSI_IPR_DUMP=y
CONFIG_SCSI_IPR_TRACE=y
CONFIG_SCSI_LPFC=m
CONFIG_SCSI_PROC_FS=y
CONFIG_SCSI_QLA_FC=m
CONFIG_SCSI_QLA_ISCSI=m
CONFIG_SECURITY_IPE=y
CONFIG_SECURITY_LOCKDOWN_LSM=y
CONFIG_SECURITY_LOCKDOWN_LSM_EARLY=y
CONFIG_SECURITY_NETWORK=y
CONFIG_SECURITY_PATH=y
CONFIG_SELECT_MEMORY_MODEL=y
CONFIG_SENSORS_IBMPOWERNV=m
CONFIG_SERIAL_8250=y
CONFIG_SERIAL_8250_16550A_VARIANTS=y
CONFIG_SERIAL_8250_CONSOLE=y
CONFIG_SERIAL_8250_DEPRECATED_OPTIONS=y
CONFIG_SERIAL_8250_EXAR=y
CONFIG_SERIAL_8250_FSL=y
CONFIG_SERIAL_8250_NR_UARTS=4
CONFIG_SERIAL_8250_PCI=y
CONFIG_SERIAL_8250_PCILIB=y
CONFIG_SERIAL_CORE_CONSOLE=y
CONFIG_SERIAL_EARLYCON=y
CONFIG_SERIAL_ICOM=m
CONFIG_SERIO_I8042=y
CONFIG_SGETMASK_SYSCALL=y
CONFIG_SHUFFLE_PAGE_ALLOCATOR=y
CONFIG_SIGNATURE=y
CONFIG_SIPHASH_KUNIT_TEST=m
CONFIG_SLAB_FREELIST_HARDENED=y
CONFIG_SLAB_FREELIST_RANDOM=y
CONFIG_SLUB_DEBUG=y
CONFIG_SLUB_KUNIT_TEST=m
CONFIG_SMT_NUM_THREADS_DYNAMIC=y
CONFIG_SND_AOA=m
CONFIG_SND_AOA_FABRIC_LAYOUT=m
CONFIG_SND_AOA_ONYX=m
CONFIG_SND_AOA_SOUNDBUS=m
CONFIG_SND_AOA_SOUNDBUS_I2S=m
CONFIG_SND_AOA_TAS=m
CONFIG_SND_AOA_TOONIE=m
CONFIG_SND_HDA_PREALLOC_SIZE=64
CONFIG_SND_PCI=y
CONFIG_SND_PCMCIA=y
CONFIG_SND_POWERMAC=m
CONFIG_SND_POWERMAC_AUTO_DRC=y
CONFIG_SND_PPC=y
CONFIG_SND_PS3=m
CONFIG_SND_PS3_DEFAULT_START_DELAY=2000
CONFIG_SOCK_CGROUP_DATA=y
CONFIG_SOFTIRQ_ON_OWN_STACK=y
CONFIG_SOFTLOCKUP_DETECTOR=y
CONFIG_SOUND_OSS_CORE_PRECLAIM=y
CONFIG_SPAPR_TCE_IOMMU=y
CONFIG_SPARSEMEM_EXTREME=y
CONFIG_SPARSEMEM_MANUAL=y
CONFIG_SPARSEMEM_VMEMMAP=y
CONFIG_SPARSEMEM_VMEMMAP_ENABLE=y
CONFIG_SPIDER_NET=m
CONFIG_SPU_BASE=y
CONFIG_SPU_FS=m
CONFIG_STACKDEPOT=y
CONFIG_STACKDEPOT_MAX_FRAMES=64
CONFIG_STACKINIT_KUNIT_TEST=m
CONFIG_STACKTRACE=y
CONFIG_STACK_TRACER=y
CONFIG_STANDALONE=y
CONFIG_STRCAT_KUNIT_TEST=m
CONFIG_STRING_SELFTEST=m
CONFIG_STRSCPY_KUNIT_TEST=m
CONFIG_SUNGEM_PHY=y
CONFIG_SYSCTL_EXCEPTION_TRACE=y
CONFIG_SYSCTL_KUNIT_TEST=m
CONFIG_SYSFS_SYSCALL=y
CONFIG_SYSVIPC_COMPAT=y
CONFIG_TARGET_CPU="power4"
CONFIG_TARGET_CPU_BOOL=y
CONFIG_TASKS_RUDE_RCU=y
CONFIG_TCG_IBMVTPM=y
CONFIG_TCG_TPM=y
CONFIG_TEST_BITMAP=m
CONFIG_TEST_BITOPS=m
CONFIG_TEST_BLACKHOLE_DEV=m
CONFIG_TEST_BPF=m
CONFIG_TEST_DIV64=m
CONFIG_TEST_FIRMWARE=m
CONFIG_TEST_FREE_PAGES=m
CONFIG_TEST_HEXDUMP=m
CONFIG_TEST_IDA=m
CONFIG_TEST_IOV_ITER=m
CONFIG_TEST_KMOD=m
CONFIG_TEST_KSTRTOX=m
CONFIG_TEST_LIST_SORT=m
CONFIG_TEST_LKM=m
CONFIG_TEST_MAPLE_TREE=m
CONFIG_TEST_MEMCAT_P=m
CONFIG_TEST_MEMINIT=m
CONFIG_TEST_MIN_HEAP=m
CONFIG_TEST_MISC_MINOR=m
CONFIG_TEST_POWER=m
CONFIG_TEST_PRINTF=m
CONFIG_TEST_REF_TRACKER=m
CONFIG_TEST_RHASHTABLE=m
CONFIG_TEST_SCANF=m
CONFIG_TEST_SORT=m
CONFIG_TEST_STATIC_KEYS=m
CONFIG_TEST_STRING_HELPERS=m
CONFIG_TEST_SYSCTL=m
CONFIG_TEST_UDELAY=m
CONFIG_TEST_USER_COPY=m
CONFIG_TEST_UUID=m
CONFIG_TEST_VMALLOC=m
CONFIG_TEST_XARRAY=m
CONFIG_THREAD_INFO_IN_TASK=y
CONFIG_THREAD_SHIFT=14
CONFIG_TIME_KUNIT_TEST=m
CONFIG_TRACEPOINTS=y
CONFIG_TRACER_MAX_TRACE=y
CONFIG_TRACER_SNAPSHOT=y
CONFIG_TRACE_CLOCK=y
CONFIG_TRACING=y
CONFIG_U3_DART=y
CONFIG_UDBG_RTAS_CONSOLE=y
CONFIG_UPROBES=y
CONFIG_UPROBE_EVENTS=y
CONFIG_USB=y
CONFIG_USB_COMMON=y
CONFIG_USB_EHCI_BIG_ENDIAN_MMIO=y
CONFIG_USB_EHCI_HCD=y
CONFIG_USB_EHCI_PCI=y
CONFIG_USB_LED_TRIG=y
CONFIG_USB_NET_DRIVERS=y
CONFIG_USB_OHCI_BIG_ENDIAN_MMIO=y
CONFIG_USB_OHCI_HCD=y
CONFIG_USB_OHCI_HCD_PCI=y
CONFIG_USB_PCI_AMD=y
CONFIG_USERCOPY_KUNIT_TEST=m
CONFIG_USE_PERCPU_NUMA_NODE_ID=y
CONFIG_VDSO32=y
CONFIG_VGA_ARB_MAX_GPUS=16
CONFIG_VHOST_TASK=y
CONFIG_VIDEO_CMDLINE=y
CONFIG_VIDEO_NOMODESET=y
CONFIG_VIRTIO_ANCHOR=y
CONFIG_VIRTIO_PCI_LIB=m
CONFIG_VIRTIO_PCI_LIB_LEGACY=m
CONFIG_VIRTUALIZATION=y
CONFIG_VIRT_CPU_ACCOUNTING=y
CONFIG_VSX=y
CONFIG_W1_MASTER_GPIO=m
CONFIG_W1_MASTER_MATROX=m
CONFIG_W1_SLAVE_DS2405=m
CONFIG_W1_SLAVE_DS2406=m
CONFIG_W1_SLAVE_DS2408_READBACK=y
CONFIG_W1_SLAVE_DS2423=m
CONFIG_W1_SLAVE_DS2430=m
CONFIG_W1_SLAVE_DS2433_CRC=y
CONFIG_W1_SLAVE_DS2438=m
CONFIG_W1_SLAVE_DS250X=m
CONFIG_W1_SLAVE_DS2805=m
CONFIG_W1_SLAVE_DS28E04=m
CONFIG_W1_SLAVE_DS28E17=m
CONFIG_WEXT_CORE=y
CONFIG_WEXT_PROC=y
CONFIG_WINDFARM=y
CONFIG_WINDFARM_PM112=y
CONFIG_WINDFARM_PM121=y
CONFIG_WINDFARM_PM81=y
CONFIG_WINDFARM_PM91=y
CONFIG_XARRAY_MULTI=y
CONFIG_XMON=y
CONFIG_XMON_DEFAULT_RO_MODE=y
CONFIG_XMON_DISASSEMBLY=y
CONFIG_XZ_DEC_IA64=y
CONFIG_XZ_DEC_POWERPC=y
CONFIG_XZ_DEC_SPARC=y
CONFIG_ZONE_DEVICE=y
CONFIG_ZPOOL=y
CONFIG_ZRAM_DEF_COMP="zstd"
CONFIG_ZSTD_COMMON=y
CONFIG_ZSTD_COMPRESS=m
```
