## riscv-omv-defconfig
```kconfig
CONFIG_64BIT=y
CONFIG_ACLINT_SSWI=y
CONFIG_ACPI=y
CONFIG_ACPI_AC=y
CONFIG_ACPI_BATTERY=y
CONFIG_ACPI_BGRT=y
CONFIG_ACPI_BUTTON=y
CONFIG_ACPI_CPPC_CPUFREQ=m
CONFIG_ACPI_CPPC_CPUFREQ_FIE=y
CONFIG_ACPI_FAN=y
CONFIG_ACPI_GENERIC_GSI=y
CONFIG_ACPI_HOTPLUG_MEMORY=y
CONFIG_ACPI_I2C_OPREGION=y
CONFIG_ACPI_MDIO=y
CONFIG_ACPI_PCC=y
CONFIG_ACPI_PROCESSOR=m
CONFIG_ACPI_REDUCED_HARDWARE_ONLY=y
CONFIG_ACPI_THERMAL=m
CONFIG_ACPI_VIDEO=m
CONFIG_ALLOW_DEV_COREDUMP=y
CONFIG_AMBA_PL08X=y
CONFIG_ANDES_CUSTOM_PMU=y
CONFIG_APERTURE_HELPERS=y
CONFIG_ARCH_ANDES=y
CONFIG_ARCH_CANAAN=y
CONFIG_ARCH_DMA_DEFAULT_COHERENT=y
CONFIG_ARCH_ENABLE_HUGEPAGE_MIGRATION=y
CONFIG_ARCH_ENABLE_SPLIT_PMD_PTLOCK=y
CONFIG_ARCH_ESWIN=y
CONFIG_ARCH_FLATMEM_ENABLE=y
CONFIG_ARCH_HAS_BINFMT_FLAT=y
CONFIG_ARCH_HAS_CURRENT_STACK_POINTER=y
CONFIG_ARCH_HAS_DEBUG_VIRTUAL=y
CONFIG_ARCH_HAS_DEBUG_VM_PGTABLE=y
CONFIG_ARCH_HAS_DEBUG_WX=y
CONFIG_ARCH_HAS_DMA_PREP_COHERENT=y
CONFIG_ARCH_HAS_KCOV=y
CONFIG_ARCH_HAS_MMIOWB=y
CONFIG_ARCH_HAS_PMEM_API=y
CONFIG_ARCH_HAS_SETUP_DMA_OPS=y
CONFIG_ARCH_HAS_SET_DIRECT_MAP=y
CONFIG_ARCH_HAS_SYNC_DMA_FOR_CPU=y
CONFIG_ARCH_HAS_SYNC_DMA_FOR_DEVICE=y
CONFIG_ARCH_HAS_SYSCALL_WRAPPER=y
CONFIG_ARCH_HAS_TICK_BROADCAST=y
CONFIG_ARCH_HAS_UBSAN_SANITIZE_ALL=y
CONFIG_ARCH_HAS_VDSO_DATA=y
CONFIG_ARCH_MICROCHIP=y
CONFIG_ARCH_MICROCHIP_POLARFIRE=y
CONFIG_ARCH_MMAP_RND_BITS=18
CONFIG_ARCH_MMAP_RND_BITS_MAX=24
CONFIG_ARCH_MMAP_RND_BITS_MIN=18
CONFIG_ARCH_MMAP_RND_COMPAT_BITS=8
CONFIG_ARCH_MMAP_RND_COMPAT_BITS_MAX=17
CONFIG_ARCH_MMAP_RND_COMPAT_BITS_MIN=8
CONFIG_ARCH_OPTIONAL_KERNEL_RWX=y
CONFIG_ARCH_OPTIONAL_KERNEL_RWX_DEFAULT=y
CONFIG_ARCH_R9A07G043=y
CONFIG_ARCH_RENESAS=y
CONFIG_ARCH_RV64I=y
CONFIG_ARCH_RZG2L=y
CONFIG_ARCH_SELECT_MEMORY_MODEL=y
CONFIG_ARCH_SIFIVE=y
CONFIG_ARCH_SOPHGO=y
CONFIG_ARCH_SPACEMIT=y
CONFIG_ARCH_STACKWALK=y
CONFIG_ARCH_STARFIVE=y
CONFIG_ARCH_SUNXI=y
CONFIG_ARCH_SUPPORTS_ACPI=y
CONFIG_ARCH_SUPPORTS_CFI_CLANG=y
CONFIG_ARCH_SUPPORTS_CRASH_DUMP=y
CONFIG_ARCH_SUPPORTS_DEBUG_PAGEALLOC=y
CONFIG_ARCH_SUPPORTS_INT128=y
CONFIG_ARCH_SUPPORTS_KEXEC=y
CONFIG_ARCH_SUPPORTS_KEXEC_FILE=y
CONFIG_ARCH_SUPPORTS_PAGE_TABLE_CHECK=y
CONFIG_ARCH_SUPPORTS_PER_VMA_LOCK=y
CONFIG_ARCH_THEAD=y
CONFIG_ARCH_USE_MEMREMAP_PROT=y
CONFIG_ARCH_USE_MEMTEST=y
CONFIG_ARCH_USE_QUEUED_RWLOCKS=y
CONFIG_ARCH_VIRT=y
CONFIG_ARCH_WANTS_THP_SWAP=y
CONFIG_ARCH_WANT_DEFAULT_TOPDOWN_MMAP_LAYOUT=y
CONFIG_ARCH_WANT_HUGE_PMD_SHARE=y
CONFIG_ARCH_WANT_LD_ORPHAN_WARN=y
CONFIG_ARCH_WANT_OPTIMIZE_HUGETLB_VMEMMAP=y
CONFIG_ASYMMETRIC_KEY_SUBTYPE=y
CONFIG_ATA_ACPI=y
CONFIG_ATA_FORCE=y
CONFIG_ATA_VERBOSE_ERROR=y
CONFIG_AT_XDMAC=m
CONFIG_AUDIT=y
CONFIG_AUDITSYSCALL=y
CONFIG_AUDIT_GENERIC=y
CONFIG_AUXILIARY_BUS=y
CONFIG_AX45MP_L2_CACHE=y
CONFIG_BACKLIGHT_88PM860X=m
CONFIG_BACKLIGHT_AAT2870=m
CONFIG_BACKLIGHT_ADP5520=m
CONFIG_BACKLIGHT_AS3711=m
CONFIG_BACKLIGHT_DA903X=m
CONFIG_BACKLIGHT_DA9052=m
CONFIG_BACKLIGHT_MAX8925=m
CONFIG_BACKLIGHT_PANDORA=m
CONFIG_BACKLIGHT_WM831X=m
CONFIG_BATTERY_88PM860X=m
CONFIG_BATTERY_DA9030=m
CONFIG_BATTERY_DA9052=m
CONFIG_BLK_CGROUP_PUNT_BIO=y
CONFIG_BLK_DEBUG_FS=y
CONFIG_BLK_DEV_BSG_COMMON=y
CONFIG_BLK_DEV_PMEM=y
CONFIG_BLK_DEV_SD=y
CONFIG_BLK_DEV_SR=y
CONFIG_BLK_ICQ=y
CONFIG_BLK_MQ_STACKING=y
CONFIG_BLOCK_HOLDER_DEPRECATED=y
CONFIG_BPF_UNPRIV_DEFAULT_OFF=y
CONFIG_BTT=y
CONFIG_BUG=y
CONFIG_CC_IMPLICIT_FALLTHROUGH="-Wimplicit-fallthrough=5"
CONFIG_CC_NO_ARRAY_BOUNDS=y
CONFIG_CC_OPTIMIZE_FOR_PERFORMANCE=y
CONFIG_CDROM=y
CONFIG_CHARGER_88PM860X=m
CONFIG_CHARGER_MAX8997=m
CONFIG_CHARGER_MAX8998=m
CONFIG_CHARGER_TPS65090=m
CONFIG_CLKSRC_MMIO=y
CONFIG_CLK_ANALOGBITS_WRPLL_CLN28HPC=y
CONFIG_CLK_R9A07G043=y
CONFIG_CLK_RENESAS=y
CONFIG_CLK_RZG2L=y
CONFIG_CLK_SIFIVE=y
CONFIG_CLK_SIFIVE_PRCI=y
CONFIG_CLK_SOPHGO_CV1800=m
CONFIG_CLK_SOPHGO_SG2042_CLKGEN=m
CONFIG_CLK_SOPHGO_SG2042_PLL=m
CONFIG_CLK_SOPHGO_SG2042_RPGATE=m
CONFIG_CLK_SOPHGO_SG2044=m
CONFIG_CLK_SOPHGO_SG2044_PLL=m
CONFIG_CLK_STARFIVE_JH7100=y
CONFIG_CLK_STARFIVE_JH7100_AUDIO=m
CONFIG_CLK_STARFIVE_JH7110_AON=m
CONFIG_CLK_STARFIVE_JH7110_ISP=m
CONFIG_CLK_STARFIVE_JH7110_PLL=y
CONFIG_CLK_STARFIVE_JH7110_STG=m
CONFIG_CLK_STARFIVE_JH7110_SYS=y
CONFIG_CLK_STARFIVE_JH7110_VOUT=m
CONFIG_CLK_STARFIVE_JH71X0=y
CONFIG_CLK_THEAD_TH1520_AP=y
CONFIG_CLK_TWL=m
CONFIG_CLK_TWL6040=m
CONFIG_CLK_WM831X=m
CONFIG_CLONE_BACKWARDS=y
CONFIG_CMDLINE=""
CONFIG_CMODEL_MEDANY=y
CONFIG_COMMON_CLK_PALMAS=m
CONFIG_COMMON_CLK_RPMI=m
CONFIG_COMMON_CLK_WM831X=m
CONFIG_COMPACT_UNEVICTABLE_DEFAULT=1
CONFIG_COMPAT=y
CONFIG_COMPAT_BINFMT_ELF=y
CONFIG_COMPAT_BRK=y
CONFIG_CONTEXT_TRACKING=y
CONFIG_CONTEXT_TRACKING_IDLE=y
CONFIG_CORE_DUMP_DEFAULT_ELF_HEADERS=y
CONFIG_CPU_IDLE_MULTIPLE_DRIVERS=y
CONFIG_CPU_PM=y
CONFIG_CRC16=y
CONFIG_CRC7=y
CONFIG_CRC_ITU_T=y
CONFIG_CRYPTO_AEAD=y
CONFIG_CRYPTO_AES_RISCV64=m
CONFIG_CRYPTO_CHACHA_RISCV64=m
CONFIG_CRYPTO_CRC32C=y
CONFIG_CRYPTO_CRC64_ROCKSOFT=m
CONFIG_CRYPTO_CTR=m
CONFIG_CRYPTO_DEV_ALLWINNER=y
CONFIG_CRYPTO_DEV_ATMEL_AES=m
CONFIG_CRYPTO_DRBG=m
CONFIG_CRYPTO_DRBG_MENU=m
CONFIG_CRYPTO_ECHAINIV=m
CONFIG_CRYPTO_ENGINE=y
CONFIG_CRYPTO_GENIV=m
CONFIG_CRYPTO_GHASH_RISCV64=m
CONFIG_CRYPTO_JITTERENTROPY=m
CONFIG_CRYPTO_LIB_GF128MUL=m
CONFIG_CRYPTO_LIB_POLY1305_RSIZE=1
CONFIG_CRYPTO_LIB_SHA1=y
CONFIG_CRYPTO_LIB_UTILS=y
CONFIG_CRYPTO_NULL=m
CONFIG_CRYPTO_NULL2=m
CONFIG_CRYPTO_RNG=m
CONFIG_CRYPTO_RNG_DEFAULT=m
CONFIG_CRYPTO_SHA256_RISCV64=m
CONFIG_CRYPTO_SHA3=m
CONFIG_CRYPTO_SHA512_RISCV64=m
CONFIG_CRYPTO_SIG2=y
CONFIG_CRYPTO_SM3_RISCV64=m
CONFIG_CRYPTO_SM4_RISCV64=m
CONFIG_CRYPTO_USER_API=y
CONFIG_CV1800_MBOX=m
CONFIG_DA9052_WATCHDOG=m
CONFIG_DA9055_WATCHDOG=m
CONFIG_DA9062_WATCHDOG=m
CONFIG_DEBUG_ATOMIC_SLEEP=y
CONFIG_DEBUG_BUGVERBOSE=y
CONFIG_DEBUG_FS_ALLOW_ALL=y
CONFIG_DEBUG_LIST=y
CONFIG_DEBUG_MEMORY_INIT=y
CONFIG_DEBUG_MISC=y
CONFIG_DEBUG_MUTEXES=y
CONFIG_DEBUG_PAGEALLOC=y
CONFIG_DEBUG_PER_CPU_MAPS=y
CONFIG_DEBUG_PLIST=y
CONFIG_DEBUG_RT_MUTEXES=y
CONFIG_DEBUG_RWSEMS=y
CONFIG_DEBUG_SG=y
CONFIG_DEBUG_SPINLOCK=y
CONFIG_DEBUG_TIMEKEEPING=y
CONFIG_DEBUG_VM=y
CONFIG_DEBUG_VM_IRQSOFF=y
CONFIG_DEBUG_VM_PGFLAGS=y
CONFIG_DEBUG_VM_PGTABLE=y
CONFIG_DECOMPRESS_BZIP2=y
CONFIG_DECOMPRESS_LZ4=y
CONFIG_DECOMPRESS_LZMA=y
CONFIG_DECOMPRESS_LZO=y
CONFIG_DEFAULT_HOSTNAME="(none)"
CONFIG_DEFAULT_HUNG_TASK_TIMEOUT=120
CONFIG_DEFAULT_MMAP_MIN_ADDR=4096
CONFIG_DETECT_HUNG_TASK=y
CONFIG_DETECT_HUNG_TASK_BLOCKER=y
CONFIG_DEVICE_PRIVATE=y
CONFIG_DMA_ACPI=y
CONFIG_DMA_BOUNCE_UNALIGNED_KMALLOC=y
CONFIG_DMA_COHERENT_POOL=y
CONFIG_DMA_DECLARE_COHERENT=y
CONFIG_DMA_DIRECT_REMAP=y
CONFIG_DMA_GLOBAL_POOL=y
CONFIG_DMA_NONCOHERENT_MMAP=y
CONFIG_DMA_OF=y
CONFIG_DMA_SUN6I=m
CONFIG_DMA_VIRTUAL_CHANNELS=m
CONFIG_DMI_SYSFS=m
CONFIG_DRM_AMDGPU_USERPTR=y
CONFIG_DRM_AMD_DC=y
CONFIG_DRM_AMD_DC_SI=y
CONFIG_DRM_CLIENT_DEFAULT_FBDEV=y
CONFIG_DRM_DISPLAY_DP_HELPER=y
CONFIG_DRM_DISPLAY_HDMI_HELPER=y
CONFIG_DRM_DISPLAY_HELPER=m
CONFIG_DRM_DW_HDMI=m
CONFIG_DRM_EFIDRM=m
CONFIG_DRM_EXEC=m
CONFIG_DRM_GEM_DMA_HELPER=m
CONFIG_DRM_GEM_SHMEM_HELPER=m
CONFIG_DRM_I2C_CH7006=m
CONFIG_DRM_I2C_SIL164=m
CONFIG_DRM_MICROCHIP_LVDS_SERIALIZER=m
CONFIG_DRM_NOUVEAU_BACKLIGHT=y
CONFIG_DRM_PANEL_ORIENTATION_QUIRKS=m
CONFIG_DRM_POWERVR=m
CONFIG_DRM_RADEON_USERPTR=y
CONFIG_DRM_RZG2L_DU=m
CONFIG_DRM_SCHED=m
CONFIG_DRM_SUBALLOC_HELPER=m
CONFIG_DRM_SUN4I=m
CONFIG_DRM_SUN6I_DSI=m
CONFIG_DRM_SUN8I_DW_HDMI=m
CONFIG_DRM_SUN8I_MIXER=m
CONFIG_DRM_SUN8I_TCON_TOP=m
CONFIG_DRM_XE_GPUSVM=y
CONFIG_DRM_XE_PAGEMAP=y
CONFIG_DTC=y
CONFIG_DT_IDLE_GENPD=y
CONFIG_DT_IDLE_STATES=y
CONFIG_DWMAC_STARFIVE=m
CONFIG_DWMAC_THEAD=m
CONFIG_EFI_EARLYCON=y
CONFIG_EFI_ESRT=y
CONFIG_EFI_GENERIC_STUB=y
CONFIG_EFI_PARAMS_FROM_FDT=y
CONFIG_EFI_RUNTIME_WRAPPERS=y
CONFIG_EFI_STUB=y
CONFIG_ERRATA_ANDES=y
CONFIG_ERRATA_ANDES_CMO=y
CONFIG_ERRATA_MIPS=y
CONFIG_ERRATA_MIPS_P8700_PAUSE_OPCODE=y
CONFIG_ERRATA_SIFIVE=y
CONFIG_ERRATA_SIFIVE_CIP_1200=y
CONFIG_ERRATA_SIFIVE_CIP_453=y
CONFIG_ERRATA_THEAD=y
CONFIG_ERRATA_THEAD_CMO=y
CONFIG_ERRATA_THEAD_GHOSTWRITE=y
CONFIG_ERRATA_THEAD_MAE=y
CONFIG_ERRATA_THEAD_PBMT=y
CONFIG_ERRATA_THEAD_PMU=y
CONFIG_EXTCON_MAX77843=m
CONFIG_EXTCON_MAX8997=m
CONFIG_EXTCON_PALMAS=m
CONFIG_EXYNOS_MBOX=m
CONFIG_FAILOVER=y
CONFIG_FB_CORE=y
CONFIG_FB_DEVICE=y
CONFIG_FB_DMAMEM_HELPERS=y
CONFIG_FB_IOMEM_HELPERS=y
CONFIG_FB_SYSMEM_HELPERS=y
CONFIG_FB_SYSMEM_HELPERS_DEFERRED=y
CONFIG_FB_SYS_COPYAREA=y
CONFIG_FB_SYS_FILLRECT=y
CONFIG_FB_SYS_FOPS=y
CONFIG_FB_SYS_IMAGEBLIT=y
CONFIG_FIPS_SIGNATURE_SELFTEST=m
CONFIG_FPU=y
CONFIG_FUNCTION_ALIGNMENT=0
CONFIG_FWNODE_MDIO=y
CONFIG_FW_CFG_SYSFS=m
CONFIG_FW_CFG_SYSFS_CMDLINE=y
CONFIG_GCC11_NO_ARRAY_BOUNDS=y
CONFIG_GCC_SUPPORTS_DYNAMIC_FTRACE=y
CONFIG_GENERIC_ARCH_TOPOLOGY=y
CONFIG_GENERIC_BUG=y
CONFIG_GENERIC_BUG_RELATIVE_POINTERS=y
CONFIG_GENERIC_CSUM=y
CONFIG_GENERIC_ENTRY=y
CONFIG_GENERIC_HWEIGHT=y
CONFIG_GENERIC_IDLE_POLL_SETUP=y
CONFIG_GENERIC_IOREMAP=y
CONFIG_GENERIC_IRQ_IPI=y
CONFIG_GENERIC_IRQ_IPI_MUX=y
CONFIG_GENERIC_IRQ_MULTI_HANDLER=y
CONFIG_GENERIC_IRQ_SHOW_LEVEL=y
CONFIG_GENERIC_LIB_DEVMEM_IS_ALLOWED=y
CONFIG_GENERIC_PINCTRL_GROUPS=y
CONFIG_GENERIC_PINMUX_FUNCTIONS=y
CONFIG_GENERIC_PTDUMP=y
CONFIG_GENERIC_SCHED_CLOCK=y
CONFIG_GENERIC_VDSO_TIME_NS=y
CONFIG_GOLDFISH=y
CONFIG_GPIO_ACPI=y
CONFIG_GPIO_ADP5520=m
CONFIG_GPIO_CDEV_V1=y
CONFIG_GPIO_DA9052=m
CONFIG_GPIO_DA9055=m
CONFIG_GPIO_GENERIC=y
CONFIG_GPIO_LJCA=m
CONFIG_GPIO_PALMAS=y
CONFIG_GPIO_PL061=m
CONFIG_GPIO_RC5T583=y
CONFIG_GPIO_SIFIVE=y
CONFIG_GPIO_SPACEMIT_K1=m
CONFIG_GPIO_TPS6586X=y
CONFIG_GPIO_TPS65910=y
CONFIG_GPIO_TWL4030=m
CONFIG_GPIO_TWL6040=m
CONFIG_GPIO_WM831X=m
CONFIG_GPIO_WM8350=m
CONFIG_HAS_IOPORT=y
CONFIG_HAS_IOPORT_MAP=y
CONFIG_HOTPLUG_CORE_SYNC=y
CONFIG_HOTPLUG_CORE_SYNC_DEAD=y
CONFIG_HSA_AMD=y
CONFIG_HSA_AMD_SVM=y
CONFIG_HVC_RISCV_SBI=y
CONFIG_HW_RANDOM_VIRTIO=y
CONFIG_HZ=250
CONFIG_HZ_250=y
CONFIG_I2C=m
CONFIG_I2C_ALGOBIT=m
CONFIG_I2C_AT91=m
CONFIG_I2C_AT91_SLAVE_EXPERIMENTAL=y
CONFIG_I2C_CADENCE=m
CONFIG_I2C_DESIGNWARE_CORE=m
CONFIG_I2C_DESIGNWARE_SLAVE=y
CONFIG_I2C_K1=m
CONFIG_I2C_MUX_GPIO=m
CONFIG_I2C_MUX_LTC4306=m
CONFIG_I2C_MUX_MLXCPLD=m
CONFIG_I2C_MUX_PCA9541=m
CONFIG_I2C_MUX_PCA954x=m
CONFIG_I2C_MV64XXX=m
CONFIG_I2C_NOMADIK=m
CONFIG_I2C_SLAVE_EEPROM=m
CONFIG_I2C_SLAVE_TESTUNIT=m
CONFIG_I2C_USBIO=m
CONFIG_INPUT_MOUSE=y
CONFIG_INPUT_MOUSEDEV=y
CONFIG_INPUT_MOUSEDEV_SCREEN_X=1024
CONFIG_INPUT_MOUSEDEV_SCREEN_Y=768
CONFIG_INPUT_VIVALDIFMAP=y
CONFIG_INTEGRITY=y
CONFIG_INTEGRITY_AUDIT=y
CONFIG_IOMMU_DEFAULT_DMA_STRICT=y
CONFIG_IPE_BOOT_POLICY=""
CONFIG_IPE_POLICY_SIG_SECONDARY_KEYRING=y
CONFIG_IRQCHIP=y
CONFIG_IRQ_STACKS=y
CONFIG_JH71XX_PMU=y
CONFIG_KCMP=y
CONFIG_KEXEC_HANDOVER=y
CONFIG_KEYBOARD_ADP5520=m
CONFIG_KEYBOARD_SUN4I_LRADC=m
CONFIG_KEYBOARD_TM2_TOUCHKEY=m
CONFIG_KEYBOARD_TWL4030=m
CONFIG_KVM=y
CONFIG_KVM_GENERIC_DIRTYLOG_READ_PROTECT=y
CONFIG_KVM_GENERIC_HARDWARE_ENABLING=y
CONFIG_KVM_MMIO=y
CONFIG_KVM_XFER_TO_GUEST_WORK=y
CONFIG_LEDS_88PM860X=m
CONFIG_LEDS_ADP5520=m
CONFIG_LEDS_AS3645A=m
CONFIG_LEDS_BD2802=m
CONFIG_LEDS_BRIGHTNESS_HW_CHANGED=y
CONFIG_LEDS_CLASS_FLASH=m
CONFIG_LEDS_DA903X=m
CONFIG_LEDS_DA9052=m
CONFIG_LEDS_DAC124S085=m
CONFIG_LEDS_GPIO=m
CONFIG_LEDS_IS31FL319X=m
CONFIG_LEDS_LM3530=m
CONFIG_LEDS_LM3532=m
CONFIG_LEDS_LM3601X=m
CONFIG_LEDS_LP3944=m
CONFIG_LEDS_LP3952=m
CONFIG_LEDS_LP8788=m
CONFIG_LEDS_LT3593=m
CONFIG_LEDS_MAX8997=m
CONFIG_LEDS_MLXREG=m
CONFIG_LEDS_PCA9532=m
CONFIG_LEDS_PCA9532_GPIO=y
CONFIG_LEDS_PCA955X=m
CONFIG_LEDS_PCA955X_GPIO=y
CONFIG_LEDS_PCA963X=m
CONFIG_LEDS_RT8515=m
CONFIG_LEDS_SGM3140=m
CONFIG_LEDS_SPI_BYTE=m
CONFIG_LEDS_SY7802=m
CONFIG_LEDS_TLC591XX=m
CONFIG_LEDS_TRIGGER_ACTIVITY=m
CONFIG_LEDS_TRIGGER_DEFAULT_ON=m
CONFIG_LEDS_TRIGGER_HEARTBEAT=m
CONFIG_LEDS_WM831X_STATUS=m
CONFIG_LEDS_WM8350=m
CONFIG_LEGACY_PTYS=y
CONFIG_LEGACY_PTY_COUNT=256
CONFIG_LEGACY_TIOCSTI=y
CONFIG_LIBFDT=y
CONFIG_LIBNVDIMM=y
CONFIG_LIST_HARDENED=y
CONFIG_LOCALVERSION_AUTO=y
CONFIG_LOCKUP_DETECTOR=y
CONFIG_LOCK_DEBUGGING_SUPPORT=y
CONFIG_LOCK_MM_AND_FIND_VMA=y
CONFIG_LOGO=y
CONFIG_LOGO_LINUX_CLUT224=y
CONFIG_LOGO_LINUX_MONO=y
CONFIG_LOGO_LINUX_VGA16=y
CONFIG_LOG_BUF_SHIFT=17
CONFIG_LSM_MMAP_MIN_ADDR=65536
CONFIG_LTO_NONE=y
CONFIG_LZ4_DECOMPRESS=y
CONFIG_LZO_COMPRESS=m
CONFIG_LZO_DECOMPRESS=y
CONFIG_MANAGER_SBS=m
CONFIG_MAX8925_POWER=m
CONFIG_MCHP_CLK_MPFS=y
CONFIG_MCHP_SBI_IPC_MBOX=m
CONFIG_MDIO_BUS=y
CONFIG_MDIO_BUS_MUX=m
CONFIG_MDIO_DEVICE=y
CONFIG_MDIO_DEVRES=y
CONFIG_MD_BITMAP_FILE=y
CONFIG_MEMFD_CREATE=y
CONFIG_MEMORY_HOTPLUG=y
CONFIG_MEMORY_HOTPLUG_DEFAULT_ONLINE=y
CONFIG_MEMORY_HOTREMOVE=y
CONFIG_MEMREGION=y
CONFIG_MFD_88PM860X=y
CONFIG_MFD_88PM886_PMIC=y
CONFIG_MFD_AAT2870_CORE=y
CONFIG_MFD_ADP5520=y
CONFIG_MFD_AS3711=y
CONFIG_MFD_DA9052_I2C=y
CONFIG_MFD_DA9055=y
CONFIG_MFD_DA9062=m
CONFIG_MFD_LP8788=y
CONFIG_MFD_MAX77541=m
CONFIG_MFD_MAX77843=y
CONFIG_MFD_MAX8925=y
CONFIG_MFD_MAX8997=y
CONFIG_MFD_MAX8998=y
CONFIG_MFD_PALMAS=m
CONFIG_MFD_RC5T583=y
CONFIG_MFD_SPACEMIT_P1=m
CONFIG_MFD_TPS65090=y
CONFIG_MFD_TPS6586X=y
CONFIG_MFD_TPS65910=y
CONFIG_MFD_TWL4030_AUDIO=y
CONFIG_MFD_WM831X_I2C=y
CONFIG_MFD_WM8350_I2C=y
CONFIG_MFD_WM8400=y
CONFIG_MHP_DEFAULT_ONLINE_TYPE_ONLINE_AUTO=y
CONFIG_MII=m
CONFIG_MMC=y
CONFIG_MMC_ARMMMCI=m
CONFIG_MMC_BLOCK=y
CONFIG_MMC_BLOCK_MINORS=8
CONFIG_MMC_SDHCI=y
CONFIG_MMC_SDHCI_CADENCE=y
CONFIG_MMC_SDHCI_NPCM=m
CONFIG_MMC_SDHCI_OF_K1=m
CONFIG_MMC_SDHCI_PLTFM=y
CONFIG_MMC_SPI=y
CONFIG_MMC_STM32_SDMMC=y
CONFIG_MMC_SUNXI=y
CONFIG_MMIOWB=y
CONFIG_MMP_PDMA=m
CONFIG_MMU_LAZY_TLB_REFCOUNT=y
CONFIG_MODULES_USE_ELF_RELA=y
CONFIG_MODULE_SECTIONS=y
CONFIG_MOUSE_PS2=y
CONFIG_MOUSE_PS2_ALPS=y
CONFIG_MOUSE_PS2_BYD=y
CONFIG_MOUSE_PS2_CYPRESS=y
CONFIG_MOUSE_PS2_FOCALTECH=y
CONFIG_MOUSE_PS2_LOGIPS2PP=y
CONFIG_MOUSE_PS2_PIXART=y
CONFIG_MOUSE_PS2_SYNAPTICS=y
CONFIG_MOUSE_PS2_SYNAPTICS_SMBUS=y
CONFIG_MOUSE_PS2_TRACKPOINT=y
CONFIG_MQ_IOSCHED_KYBER=y
CONFIG_MUX_ADGS1408=m
CONFIG_ND_BTT=y
CONFIG_ND_CLAIM=y
CONFIG_NET_9P=y
CONFIG_NET_9P_FD=y
CONFIG_NET_9P_VIRTIO=y
CONFIG_NET_FAILOVER=y
CONFIG_NET_SELFTESTS=y
CONFIG_NET_VENDOR_SPACEMIT=y
CONFIG_NIC7018_WDT=m
CONFIG_NOUVEAU_DEBUG=5
CONFIG_NOUVEAU_DEBUG_DEFAULT=3
CONFIG_NR_CPUS=64
CONFIG_NVDIMM_DAX=y
CONFIG_NVDIMM_PFN=y
CONFIG_NVMEM_SUNXI_SID=y
CONFIG_OF=y
CONFIG_OF_ADDRESS=y
CONFIG_OF_EARLY_FLATTREE=y
CONFIG_OF_FLATTREE=y
CONFIG_OF_GPIO=y
CONFIG_OF_IOMMU=y
CONFIG_OF_IRQ=y
CONFIG_OF_KOBJ=y
CONFIG_OF_MDIO=y
CONFIG_OF_PMEM=y
CONFIG_OF_RESERVED_MEM=y
CONFIG_PAGE_BLOCK_MAX_ORDER=10
CONFIG_PAGE_BLOCK_ORDER=10
CONFIG_PAGE_OFFSET=0xff60000000000000
CONFIG_PAGE_SIZE_LESS_THAN_256KB=y
CONFIG_PAGE_SIZE_LESS_THAN_64KB=y
CONFIG_PANIC_TIMEOUT=0
CONFIG_PARAVIRT=y
CONFIG_PATA_TIMINGS=y
CONFIG_PCC=y
CONFIG_PCIE_DW=y
CONFIG_PCIE_DW_HOST=y
CONFIG_PCIE_FU740=y
CONFIG_PCIE_RCAR_GEN4_HOST=m
CONFIG_PCIE_SG2042_HOST=m
CONFIG_PCIE_SOPHGO_DW=y
CONFIG_PCIE_STARFIVE_HOST=m
CONFIG_PCIE_XILINX_DMA_PL=y
CONFIG_PCI_DOE=y
CONFIG_PCI_DOMAINS_GENERIC=y
CONFIG_PCI_ECAM=y
CONFIG_PCI_HOST_COMMON=y
CONFIG_PCI_HOST_GENERIC=y
CONFIG_PCI_LABEL=y
CONFIG_PCI_P2PDMA=y
CONFIG_PER_VMA_LOCK=y
CONFIG_PGTABLE_LEVELS=5
CONFIG_PHY_SOPHGO_CV1800_USB2=m
CONFIG_PHY_STARFIVE_JH7110_DPHY_RX=m
CONFIG_PHY_STARFIVE_JH7110_DPHY_TX=m
CONFIG_PHY_STARFIVE_JH7110_PCIE=m
CONFIG_PHY_STARFIVE_JH7110_USB=m
CONFIG_PHY_SUN4I_USB=m
CONFIG_PHY_SUN6I_MIPI_DPHY=m
CONFIG_PINCTRL_DA9062=m
CONFIG_PINCTRL_EIC7700=m
CONFIG_PINCTRL_K230=y
CONFIG_PINCTRL_RENESAS=y
CONFIG_PINCTRL_RZG2L=y
CONFIG_PINCTRL_SOPHGO_CV1800B=m
CONFIG_PINCTRL_SOPHGO_CV1812H=m
CONFIG_PINCTRL_SOPHGO_SG2000=m
CONFIG_PINCTRL_SOPHGO_SG2002=m
CONFIG_PINCTRL_SOPHGO_SG2042=m
CONFIG_PINCTRL_SOPHGO_SG2044=m
CONFIG_PINCTRL_SPACEMIT_K1=y
CONFIG_PINCTRL_STARFIVE_JH7100=y
CONFIG_PINCTRL_STARFIVE_JH7110=y
CONFIG_PINCTRL_STARFIVE_JH7110_AON=y
CONFIG_PINCTRL_STARFIVE_JH7110_SYS=y
CONFIG_PINCTRL_SUN20I_D1=y
CONFIG_PINCTRL_SUNXI=y
CONFIG_PINCTRL_SX150X=y
CONFIG_PINCTRL_TH1520=m
CONFIG_PKCS7_TEST_KEY=m
CONFIG_PL330_DMA=m
CONFIG_PMIC_ADP5520=y
CONFIG_PMIC_DA903X=y
CONFIG_PM_GENERIC_DOMAINS_OF=y
CONFIG_PNP=y
CONFIG_PNPACPI=y
CONFIG_PNP_DEBUG_MESSAGES=y
CONFIG_POLARFIRE_SOC_MAILBOX=m
CONFIG_PORTABLE=y
CONFIG_POSIX_CPU_TIMERS_TASK_WORK=y
CONFIG_POWER_RESET_TH1520_AON=m
CONFIG_PREEMPT_NONE=y
CONFIG_PREEMPT_NONE_BUILD=y
CONFIG_PREEMPT_NOTIFIERS=y
CONFIG_PRINTK_TIME=y
CONFIG_PTP_1588_CLOCK_OPTIONAL=y
CONFIG_PWRSEQ_EMMC=y
CONFIG_PWRSEQ_SIMPLE=y
CONFIG_QUEUED_RWLOCKS=y
CONFIG_RAID6_PQ_BENCHMARK=y
CONFIG_RANDOMIZE_KSTACK_OFFSET_DEFAULT=y
CONFIG_RCU_EQS_DEBUG=y
CONFIG_RD_BZIP2=y
CONFIG_RD_LZ4=y
CONFIG_RD_LZMA=y
CONFIG_RD_LZO=y
CONFIG_REGUALTOR_STPMIC1=m
CONFIG_REGULATOR_88PM8607=m
CONFIG_REGULATOR_AAT2870=m
CONFIG_REGULATOR_AS3711=m
CONFIG_REGULATOR_DA9052=m
CONFIG_REGULATOR_DA9055=m
CONFIG_REGULATOR_DA9062=m
CONFIG_REGULATOR_FIXED_VOLTAGE=y
CONFIG_REGULATOR_LP8788=m
CONFIG_REGULATOR_MAX77541=m
CONFIG_REGULATOR_MAX77693=m
CONFIG_REGULATOR_MAX8925=m
CONFIG_REGULATOR_MAX8997=m
CONFIG_REGULATOR_MAX8998=m
CONFIG_REGULATOR_PALMAS=m
CONFIG_REGULATOR_RASPBERRYPI_TOUCHSCREEN_V2=m
CONFIG_REGULATOR_RC5T583=m
CONFIG_REGULATOR_SPACEMIT_P1=m
CONFIG_REGULATOR_TPS65090=m
CONFIG_REGULATOR_TPS6586X=m
CONFIG_REGULATOR_TPS65910=m
CONFIG_REGULATOR_TWL4030=m
CONFIG_REGULATOR_WM831X=m
CONFIG_REGULATOR_WM8350=m
CONFIG_REGULATOR_WM8400=m
CONFIG_RENESAS_RZG2L_IRQC=y
CONFIG_RENESAS_RZV2HWDT=m
CONFIG_RESET_K230=m
CONFIG_RESET_POLARFIRE_SOC=y
CONFIG_RESET_SPACEMIT=m
CONFIG_RESET_STARFIVE_JH7100=y
CONFIG_RESET_STARFIVE_JH7110=y
CONFIG_RESET_STARFIVE_JH71X0=y
CONFIG_RESET_SUNXI=y
CONFIG_RESET_TH1520=m
CONFIG_RISCV=y
CONFIG_RISCV_ALTERNATIVE=y
CONFIG_RISCV_ALTERNATIVE_EARLY=y
CONFIG_RISCV_COMBO_SPINLOCKS=y
CONFIG_RISCV_DMA_NONCOHERENT=y
CONFIG_RISCV_EMULATED_UNALIGNED_ACCESS=y
CONFIG_RISCV_INTC=y
CONFIG_RISCV_IOMMU=y
CONFIG_RISCV_ISA_C=y
CONFIG_RISCV_ISA_FALLBACK=y
CONFIG_RISCV_ISA_SUPM=y
CONFIG_RISCV_ISA_SVNAPOT=y
CONFIG_RISCV_ISA_SVPBMT=y
CONFIG_RISCV_ISA_V=y
CONFIG_RISCV_ISA_VENDOR_EXT_ANDES=y
CONFIG_RISCV_ISA_VENDOR_EXT_MIPS=y
CONFIG_RISCV_ISA_VENDOR_EXT_SIFIVE=y
CONFIG_RISCV_ISA_VENDOR_EXT_THEAD=y
CONFIG_RISCV_ISA_V_DEFAULT_ENABLE=y
CONFIG_RISCV_ISA_V_PREEMPTIVE=y
CONFIG_RISCV_ISA_V_UCOPY_THRESHOLD=768
CONFIG_RISCV_ISA_XTHEADVECTOR=y
CONFIG_RISCV_ISA_ZABHA=y
CONFIG_RISCV_ISA_ZACAS=y
CONFIG_RISCV_ISA_ZAWRS=y
CONFIG_RISCV_ISA_ZBA=y
CONFIG_RISCV_ISA_ZBB=y
CONFIG_RISCV_ISA_ZBC=y
CONFIG_RISCV_ISA_ZBKB=y
CONFIG_RISCV_ISA_ZICBOM=y
CONFIG_RISCV_ISA_ZICBOP=y
CONFIG_RISCV_ISA_ZICBOZ=y
CONFIG_RISCV_MISALIGNED=y
CONFIG_RISCV_NONSTANDARD_CACHE_OPS=y
CONFIG_RISCV_PMU=y
CONFIG_RISCV_PMU_LEGACY=y
CONFIG_RISCV_PMU_SBI=y
CONFIG_RISCV_SBI=y
CONFIG_RISCV_SBI_CPUIDLE=y
CONFIG_RISCV_SBI_MPXY_MBOX=m
CONFIG_RISCV_TIMER=y
CONFIG_RPMSG=y
CONFIG_RPMSG_CHAR=y
CONFIG_RPMSG_CTRL=y
CONFIG_RPMSG_NS=y
CONFIG_RPMSG_VIRTIO=y
CONFIG_RTC_DRV_88PM860X=m
CONFIG_RTC_DRV_CV1800=m
CONFIG_RTC_DRV_DA9052=m
CONFIG_RTC_DRV_DA9055=m
CONFIG_RTC_DRV_DA9063=m
CONFIG_RTC_DRV_LP8788=m
CONFIG_RTC_DRV_MAX8925=m
CONFIG_RTC_DRV_MAX8997=m
CONFIG_RTC_DRV_MAX8998=m
CONFIG_RTC_DRV_PALMAS=m
CONFIG_RTC_DRV_PL030=m
CONFIG_RTC_DRV_PL031=m
CONFIG_RTC_DRV_RC5T583=m
CONFIG_RTC_DRV_SPACEMIT_P1=m
CONFIG_RTC_DRV_SUN6I=y
CONFIG_RTC_DRV_TPS6586X=m
CONFIG_RTC_DRV_TPS65910=m
CONFIG_RTC_DRV_WM831X=m
CONFIG_RTC_DRV_WM8350=m
CONFIG_RTC_I2C_AND_SPI=m
CONFIG_RTC_INTF_PROC=y
CONFIG_RT_GROUP_SCHED=y
CONFIG_RXPERF=m
CONFIG_RZG3E_THERMAL=m
CONFIG_SCHED_DEBUG=y
CONFIG_SCHED_MM_CID=y
CONFIG_SCHED_STACK_END_CHECK=y
CONFIG_SCSI_COMMON=y
CONFIG_SCSI_PROC_FS=y
CONFIG_SECURITY_IPE=y
CONFIG_SECURITY_NETWORK=y
CONFIG_SECURITY_PATH=y
CONFIG_SELECT_MEMORY_MODEL=y
CONFIG_SENSORS_DA9055=m
CONFIG_SENSORS_SFCTEMP=m
CONFIG_SENSORS_WM8350=m
CONFIG_SENSORS_XGENE=m
CONFIG_SERIAL_8250=y
CONFIG_SERIAL_8250_16550A_VARIANTS=y
CONFIG_SERIAL_8250_CONSOLE=y
CONFIG_SERIAL_8250_DEPRECATED_OPTIONS=y
CONFIG_SERIAL_8250_DW=y
CONFIG_SERIAL_8250_EXAR=y
CONFIG_SERIAL_8250_NR_UARTS=4
CONFIG_SERIAL_8250_PCI=y
CONFIG_SERIAL_8250_PCILIB=y
CONFIG_SERIAL_8250_PNP=y
CONFIG_SERIAL_AMBA_PL010=m
CONFIG_SERIAL_AMBA_PL011=m
CONFIG_SERIAL_ATMEL=y
CONFIG_SERIAL_ATMEL_CONSOLE=y
CONFIG_SERIAL_ATMEL_PDC=y
CONFIG_SERIAL_CORE_CONSOLE=y
CONFIG_SERIAL_EARLYCON=y
CONFIG_SERIAL_EARLYCON_RISCV_SBI=y
CONFIG_SERIAL_MCTRL_GPIO=y
CONFIG_SERIAL_OF_PLATFORM=y
CONFIG_SERIAL_RSCI=m
CONFIG_SERIAL_SH_SCI=y
CONFIG_SERIAL_SH_SCI_CONSOLE=y
CONFIG_SERIAL_SH_SCI_DMA=y
CONFIG_SERIAL_SH_SCI_EARLYCON=y
CONFIG_SERIAL_SH_SCI_NR_UARTS=18
CONFIG_SERIAL_SIFIVE=y
CONFIG_SERIAL_SIFIVE_CONSOLE=y
CONFIG_SERIO_AMBAKMI=m
CONFIG_SIFIVE_PLIC=y
CONFIG_SLAB_MERGE_DEFAULT=y
CONFIG_SLUB_DEBUG=y
CONFIG_SOCK_CGROUP_DATA=y
CONFIG_SOC_MICROCHIP_POLARFIRE=y
CONFIG_SOC_RENESAS=y
CONFIG_SOC_SIFIVE=y
CONFIG_SOC_STARFIVE=y
CONFIG_SOC_VIRT=y
CONFIG_SOFTIRQ_ON_OWN_STACK=y
CONFIG_SOFTLOCKUP_DETECTOR=y
CONFIG_SOPHGO_CV1800B_DMAMUX=m
CONFIG_SOPHGO_CV1800_RTCSYS=m
CONFIG_SOPHGO_SG2042_MSI=y
CONFIG_SOPHGO_SG2044_TOPSYS=m
CONFIG_SPACEMIT_CCU=m
CONFIG_SPACEMIT_K1_CCU=m
CONFIG_SPACEMIT_K1_EMAC=m
CONFIG_SPARSEMEM_EXTREME=y
CONFIG_SPARSEMEM_MANUAL=y
CONFIG_SPARSEMEM_VMEMMAP=y
CONFIG_SPARSEMEM_VMEMMAP_ENABLE=y
CONFIG_SPI_ATMEL=m
CONFIG_SPI_LJCA=m
CONFIG_SPI_PL022=m
CONFIG_SPI_RZV2H_RSPI=m
CONFIG_SPI_SG2044_NOR=m
CONFIG_SPI_SIFIVE=y
CONFIG_SPI_SUN6I=y
CONFIG_SSB=m
CONFIG_SSB_DRIVER_GPIO=y
CONFIG_STACKDEPOT=y
CONFIG_STACKDEPOT_MAX_FRAMES=64
CONFIG_STACKTRACE=y
CONFIG_STANDALONE=y
CONFIG_STARFIVE_JH8100_INTC=y
CONFIG_STARFIVE_STARLINK_CACHE=y
CONFIG_STARFIVE_STARLINK_PMU=y
CONFIG_STARFIVE_WATCHDOG=y
CONFIG_SUN20I_D1_CCU=y
CONFIG_SUN20I_D1_R_CCU=y
CONFIG_SUN4I_TIMER=y
CONFIG_SUN50I_IOMMU=y
CONFIG_SUN6I_MSGBOX=m
CONFIG_SUN6I_RTC_CCU=y
CONFIG_SUN8I_DE2_CCU=m
CONFIG_SUNXI_CCU=y
CONFIG_SUNXI_SRAM=y
CONFIG_SUNXI_WATCHDOG=y
CONFIG_SYSCTL_EXCEPTION_TRACE=y
CONFIG_SYSTEM_EXTRA_CERTIFICATE=y
CONFIG_SYSTEM_EXTRA_CERTIFICATE_SIZE=4096
CONFIG_SYSVIPC_COMPAT=y
CONFIG_TH1520_AON_PROTOCOL=m
CONFIG_TH1520_PM_DOMAINS=m
CONFIG_THEAD_C900_ACLINT_SSWI=y
CONFIG_THEAD_TH1520_MBOX=m
CONFIG_THERMAL_EMERGENCY_POWEROFF_DELAY_MS=0
CONFIG_THREAD_INFO_IN_TASK=y
CONFIG_THREAD_SIZE_ORDER=2
CONFIG_TICK_CPU_ACCOUNTING=y
CONFIG_TIMER_OF=y
CONFIG_TIMER_PROBE=y
CONFIG_TOOLCHAIN_NEEDS_EXPLICIT_ZICSR_ZIFENCEI=y
CONFIG_TPS65090=y
CONFIG_TUNE_GENERIC=y
CONFIG_TWL4030_CORE=y
CONFIG_TWL4030_WATCHDOG=m
CONFIG_TWL6040_CORE=y
CONFIG_UCS2_STRING=y
CONFIG_UIO_AEC=m
CONFIG_UIO_DMEM_GENIRQ=m
CONFIG_UIO_MF624=m
CONFIG_UIO_NETX=m
CONFIG_UIO_PCI_GENERIC=m
CONFIG_UIO_PDRV_GENIRQ=m
CONFIG_UIO_PRUSS=m
CONFIG_USB=y
CONFIG_USB_COMMON=y
CONFIG_USB_EHCI_HCD=y
CONFIG_USB_EHCI_HCD_PLATFORM=y
CONFIG_USB_EHCI_PCI=y
CONFIG_USB_LED_TRIG=y
CONFIG_USB_MUSB_HDRC=m
CONFIG_USB_MUSB_HOST=y
CONFIG_USB_MUSB_SUNXI=m
CONFIG_USB_NET_DRIVERS=y
CONFIG_USB_OHCI_HCD=y
CONFIG_USB_OHCI_HCD_PCI=y
CONFIG_USB_OHCI_HCD_PLATFORM=y
CONFIG_USB_UAS=y
CONFIG_USB_USBIO=m
CONFIG_USB_XHCI_RCAR=y
CONFIG_VGA_ARB_MAX_GPUS=16
CONFIG_VGA_CONSOLE=y
CONFIG_VIDEO_CMDLINE=y
CONFIG_VIDEO_NOMODESET=y
CONFIG_VIRTIO_ANCHOR=y
CONFIG_VIRTIO_PCI_LIB=y
CONFIG_VIRTIO_PCI_LIB_LEGACY=y
CONFIG_VIRTUALIZATION=y
CONFIG_VMAP_STACK=y
CONFIG_WM831X_BACKUP=m
CONFIG_WM831X_POWER=m
CONFIG_WM831X_WATCHDOG=m
CONFIG_WM8350_POWER=m
CONFIG_WM8350_WATCHDOG=m
CONFIG_WQ_WATCHDOG=y
CONFIG_XZ_DEC_IA64=y
CONFIG_XZ_DEC_POWERPC=y
CONFIG_XZ_DEC_SPARC=y
CONFIG_ZLIB_DEFLATE=m
CONFIG_ZONE_DEVICE=y
CONFIG_ZONE_DMA32=y
CONFIG_ZRAM_MEMORY_TRACKING=y
CONFIG_ZRAM_WRITEBACK=y
CONFIG_ZSTD_COMMON=y
```
